//Standalone Multifunction Synthesizer.
//コンパイラ最適化オプション　コードサイズ優先
#pragma GCC optimize ("-Os")
#include "symbol.h"
#include "struct.h"
//楽譜進行定義
 __attribute__ ((aligned (256))) struct conductor CON[7];
//DDS定義
 __attribute__ ((aligned (256))) struct waveDDS wDDS[6];
struct noiseDDS nDDS;
//エンペロープ構造体定義
 __attribute__ ((aligned (256))) struct envelope env[13];
#define cEnv(ch) env[ch]
#define mEnv(ch) env[ch+7]
//変調LFO機能
struct LFO LFO[6];
//ピッチベント
struct pitchBend pb[7];
//波形テーブル
 __attribute__ ((aligned (256))) volatile constexpr PROGMEM const int8_t sinSampling[]={PWM_DUTY_SIN(0),PWM_DUTY_SIN(1),PWM_DUTY_SIN(2),PWM_DUTY_SIN(3),PWM_DUTY_SIN(4),PWM_DUTY_SIN(5),PWM_DUTY_SIN(6),PWM_DUTY_SIN(7),PWM_DUTY_SIN(8),PWM_DUTY_SIN(9),PWM_DUTY_SIN(10),PWM_DUTY_SIN(11),PWM_DUTY_SIN(12),PWM_DUTY_SIN(13),PWM_DUTY_SIN(14),PWM_DUTY_SIN(15),PWM_DUTY_SIN(16),PWM_DUTY_SIN(17),PWM_DUTY_SIN(18),PWM_DUTY_SIN(19),PWM_DUTY_SIN(20),PWM_DUTY_SIN(21),PWM_DUTY_SIN(22),PWM_DUTY_SIN(23),PWM_DUTY_SIN(24),PWM_DUTY_SIN(25),PWM_DUTY_SIN(26),PWM_DUTY_SIN(27),PWM_DUTY_SIN(28),PWM_DUTY_SIN(29),PWM_DUTY_SIN(30),PWM_DUTY_SIN(31),PWM_DUTY_SIN(32),PWM_DUTY_SIN(33),PWM_DUTY_SIN(34),PWM_DUTY_SIN(35),PWM_DUTY_SIN(36),PWM_DUTY_SIN(37),PWM_DUTY_SIN(38),PWM_DUTY_SIN(39),PWM_DUTY_SIN(40),PWM_DUTY_SIN(41),PWM_DUTY_SIN(42),PWM_DUTY_SIN(43),PWM_DUTY_SIN(44),PWM_DUTY_SIN(45),PWM_DUTY_SIN(46),PWM_DUTY_SIN(47),PWM_DUTY_SIN(48),PWM_DUTY_SIN(49),PWM_DUTY_SIN(50),PWM_DUTY_SIN(51),PWM_DUTY_SIN(52),PWM_DUTY_SIN(53),PWM_DUTY_SIN(54),PWM_DUTY_SIN(55),PWM_DUTY_SIN(56),PWM_DUTY_SIN(57),PWM_DUTY_SIN(58),PWM_DUTY_SIN(59),PWM_DUTY_SIN(60),PWM_DUTY_SIN(61),PWM_DUTY_SIN(62),PWM_DUTY_SIN(63),PWM_DUTY_SIN(64),PWM_DUTY_SIN(65),PWM_DUTY_SIN(66),PWM_DUTY_SIN(67),PWM_DUTY_SIN(68),PWM_DUTY_SIN(69),PWM_DUTY_SIN(70),PWM_DUTY_SIN(71),PWM_DUTY_SIN(72),PWM_DUTY_SIN(73),PWM_DUTY_SIN(74),PWM_DUTY_SIN(75),PWM_DUTY_SIN(76),PWM_DUTY_SIN(77),PWM_DUTY_SIN(78),PWM_DUTY_SIN(79),PWM_DUTY_SIN(80),PWM_DUTY_SIN(81),PWM_DUTY_SIN(82),PWM_DUTY_SIN(83),PWM_DUTY_SIN(84),PWM_DUTY_SIN(85),PWM_DUTY_SIN(86),PWM_DUTY_SIN(87),PWM_DUTY_SIN(88),PWM_DUTY_SIN(89),PWM_DUTY_SIN(90),PWM_DUTY_SIN(91),PWM_DUTY_SIN(92),PWM_DUTY_SIN(93),PWM_DUTY_SIN(94),PWM_DUTY_SIN(95),PWM_DUTY_SIN(96),PWM_DUTY_SIN(97),PWM_DUTY_SIN(98),PWM_DUTY_SIN(99),PWM_DUTY_SIN(100),PWM_DUTY_SIN(101),PWM_DUTY_SIN(102),PWM_DUTY_SIN(103),PWM_DUTY_SIN(104),PWM_DUTY_SIN(105),PWM_DUTY_SIN(106),PWM_DUTY_SIN(107),PWM_DUTY_SIN(108),PWM_DUTY_SIN(109),PWM_DUTY_SIN(110),PWM_DUTY_SIN(111),PWM_DUTY_SIN(112),PWM_DUTY_SIN(113),PWM_DUTY_SIN(114),PWM_DUTY_SIN(115),PWM_DUTY_SIN(116),PWM_DUTY_SIN(117),PWM_DUTY_SIN(118),PWM_DUTY_SIN(119),PWM_DUTY_SIN(120),PWM_DUTY_SIN(121),PWM_DUTY_SIN(122),PWM_DUTY_SIN(123),PWM_DUTY_SIN(124),PWM_DUTY_SIN(125),PWM_DUTY_SIN(126),PWM_DUTY_SIN(127),PWM_DUTY_SIN(128),PWM_DUTY_SIN(129),PWM_DUTY_SIN(130),PWM_DUTY_SIN(131),PWM_DUTY_SIN(132),PWM_DUTY_SIN(133),PWM_DUTY_SIN(134),PWM_DUTY_SIN(135),PWM_DUTY_SIN(136),PWM_DUTY_SIN(137),PWM_DUTY_SIN(138),PWM_DUTY_SIN(139),PWM_DUTY_SIN(140),PWM_DUTY_SIN(141),PWM_DUTY_SIN(142),PWM_DUTY_SIN(143),PWM_DUTY_SIN(144),PWM_DUTY_SIN(145),PWM_DUTY_SIN(146),PWM_DUTY_SIN(147),PWM_DUTY_SIN(148),PWM_DUTY_SIN(149),PWM_DUTY_SIN(150),PWM_DUTY_SIN(151),PWM_DUTY_SIN(152),PWM_DUTY_SIN(153),PWM_DUTY_SIN(154),PWM_DUTY_SIN(155),PWM_DUTY_SIN(156),PWM_DUTY_SIN(157),PWM_DUTY_SIN(158),PWM_DUTY_SIN(159),PWM_DUTY_SIN(160),PWM_DUTY_SIN(161),PWM_DUTY_SIN(162),PWM_DUTY_SIN(163),PWM_DUTY_SIN(164),PWM_DUTY_SIN(165),PWM_DUTY_SIN(166),PWM_DUTY_SIN(167),PWM_DUTY_SIN(168),PWM_DUTY_SIN(169),PWM_DUTY_SIN(170),PWM_DUTY_SIN(171),PWM_DUTY_SIN(172),PWM_DUTY_SIN(173),PWM_DUTY_SIN(174),PWM_DUTY_SIN(175),PWM_DUTY_SIN(176),PWM_DUTY_SIN(177),PWM_DUTY_SIN(178),PWM_DUTY_SIN(179),PWM_DUTY_SIN(180),PWM_DUTY_SIN(181),PWM_DUTY_SIN(182),PWM_DUTY_SIN(183),PWM_DUTY_SIN(184),PWM_DUTY_SIN(185),PWM_DUTY_SIN(186),PWM_DUTY_SIN(187),PWM_DUTY_SIN(188),PWM_DUTY_SIN(189),PWM_DUTY_SIN(190),PWM_DUTY_SIN(191),PWM_DUTY_SIN(192),PWM_DUTY_SIN(193),PWM_DUTY_SIN(194),PWM_DUTY_SIN(195),PWM_DUTY_SIN(196),PWM_DUTY_SIN(197),PWM_DUTY_SIN(198),PWM_DUTY_SIN(199),PWM_DUTY_SIN(200),PWM_DUTY_SIN(201),PWM_DUTY_SIN(202),PWM_DUTY_SIN(203),PWM_DUTY_SIN(204),PWM_DUTY_SIN(205),PWM_DUTY_SIN(206),PWM_DUTY_SIN(207),PWM_DUTY_SIN(208),PWM_DUTY_SIN(209),PWM_DUTY_SIN(210),PWM_DUTY_SIN(211),PWM_DUTY_SIN(212),PWM_DUTY_SIN(213),PWM_DUTY_SIN(214),PWM_DUTY_SIN(215),PWM_DUTY_SIN(216),PWM_DUTY_SIN(217),PWM_DUTY_SIN(218),PWM_DUTY_SIN(219),PWM_DUTY_SIN(220),PWM_DUTY_SIN(221),PWM_DUTY_SIN(222),PWM_DUTY_SIN(223),PWM_DUTY_SIN(224),PWM_DUTY_SIN(225),PWM_DUTY_SIN(226),PWM_DUTY_SIN(227),PWM_DUTY_SIN(228),PWM_DUTY_SIN(229),PWM_DUTY_SIN(230),PWM_DUTY_SIN(231),PWM_DUTY_SIN(232),PWM_DUTY_SIN(233),PWM_DUTY_SIN(234),PWM_DUTY_SIN(235),PWM_DUTY_SIN(236),PWM_DUTY_SIN(237),PWM_DUTY_SIN(238),PWM_DUTY_SIN(239),PWM_DUTY_SIN(240),PWM_DUTY_SIN(241),PWM_DUTY_SIN(242),PWM_DUTY_SIN(243),PWM_DUTY_SIN(244),PWM_DUTY_SIN(245),PWM_DUTY_SIN(246),PWM_DUTY_SIN(247),PWM_DUTY_SIN(248),PWM_DUTY_SIN(249),PWM_DUTY_SIN(250),PWM_DUTY_SIN(251),PWM_DUTY_SIN(252),PWM_DUTY_SIN(253),PWM_DUTY_SIN(254),PWM_DUTY_SIN(255)};
 __attribute__ ((aligned (256))) volatile constexpr PROGMEM const int8_t sawSampling[]={PWM_DUTY_SAW(0),PWM_DUTY_SAW(1),PWM_DUTY_SAW(2),PWM_DUTY_SAW(3),PWM_DUTY_SAW(4),PWM_DUTY_SAW(5),PWM_DUTY_SAW(6),PWM_DUTY_SAW(7),PWM_DUTY_SAW(8),PWM_DUTY_SAW(9),PWM_DUTY_SAW(10),PWM_DUTY_SAW(11),PWM_DUTY_SAW(12),PWM_DUTY_SAW(13),PWM_DUTY_SAW(14),PWM_DUTY_SAW(15),PWM_DUTY_SAW(16),PWM_DUTY_SAW(17),PWM_DUTY_SAW(18),PWM_DUTY_SAW(19),PWM_DUTY_SAW(20),PWM_DUTY_SAW(21),PWM_DUTY_SAW(22),PWM_DUTY_SAW(23),PWM_DUTY_SAW(24),PWM_DUTY_SAW(25),PWM_DUTY_SAW(26),PWM_DUTY_SAW(27),PWM_DUTY_SAW(28),PWM_DUTY_SAW(29),PWM_DUTY_SAW(30),PWM_DUTY_SAW(31),PWM_DUTY_SAW(32),PWM_DUTY_SAW(33),PWM_DUTY_SAW(34),PWM_DUTY_SAW(35),PWM_DUTY_SAW(36),PWM_DUTY_SAW(37),PWM_DUTY_SAW(38),PWM_DUTY_SAW(39),PWM_DUTY_SAW(40),PWM_DUTY_SAW(41),PWM_DUTY_SAW(42),PWM_DUTY_SAW(43),PWM_DUTY_SAW(44),PWM_DUTY_SAW(45),PWM_DUTY_SAW(46),PWM_DUTY_SAW(47),PWM_DUTY_SAW(48),PWM_DUTY_SAW(49),PWM_DUTY_SAW(50),PWM_DUTY_SAW(51),PWM_DUTY_SAW(52),PWM_DUTY_SAW(53),PWM_DUTY_SAW(54),PWM_DUTY_SAW(55),PWM_DUTY_SAW(56),PWM_DUTY_SAW(57),PWM_DUTY_SAW(58),PWM_DUTY_SAW(59),PWM_DUTY_SAW(60),PWM_DUTY_SAW(61),PWM_DUTY_SAW(62),PWM_DUTY_SAW(63),PWM_DUTY_SAW(64),PWM_DUTY_SAW(65),PWM_DUTY_SAW(66),PWM_DUTY_SAW(67),PWM_DUTY_SAW(68),PWM_DUTY_SAW(69),PWM_DUTY_SAW(70),PWM_DUTY_SAW(71),PWM_DUTY_SAW(72),PWM_DUTY_SAW(73),PWM_DUTY_SAW(74),PWM_DUTY_SAW(75),PWM_DUTY_SAW(76),PWM_DUTY_SAW(77),PWM_DUTY_SAW(78),PWM_DUTY_SAW(79),PWM_DUTY_SAW(80),PWM_DUTY_SAW(81),PWM_DUTY_SAW(82),PWM_DUTY_SAW(83),PWM_DUTY_SAW(84),PWM_DUTY_SAW(85),PWM_DUTY_SAW(86),PWM_DUTY_SAW(87),PWM_DUTY_SAW(88),PWM_DUTY_SAW(89),PWM_DUTY_SAW(90),PWM_DUTY_SAW(91),PWM_DUTY_SAW(92),PWM_DUTY_SAW(93),PWM_DUTY_SAW(94),PWM_DUTY_SAW(95),PWM_DUTY_SAW(96),PWM_DUTY_SAW(97),PWM_DUTY_SAW(98),PWM_DUTY_SAW(99),PWM_DUTY_SAW(100),PWM_DUTY_SAW(101),PWM_DUTY_SAW(102),PWM_DUTY_SAW(103),PWM_DUTY_SAW(104),PWM_DUTY_SAW(105),PWM_DUTY_SAW(106),PWM_DUTY_SAW(107),PWM_DUTY_SAW(108),PWM_DUTY_SAW(109),PWM_DUTY_SAW(110),PWM_DUTY_SAW(111),PWM_DUTY_SAW(112),PWM_DUTY_SAW(113),PWM_DUTY_SAW(114),PWM_DUTY_SAW(115),PWM_DUTY_SAW(116),PWM_DUTY_SAW(117),PWM_DUTY_SAW(118),PWM_DUTY_SAW(119),PWM_DUTY_SAW(120),PWM_DUTY_SAW(121),PWM_DUTY_SAW(122),PWM_DUTY_SAW(123),PWM_DUTY_SAW(124),PWM_DUTY_SAW(125),PWM_DUTY_SAW(126),PWM_DUTY_SAW(127),PWM_DUTY_SAW(128),PWM_DUTY_SAW(129),PWM_DUTY_SAW(130),PWM_DUTY_SAW(131),PWM_DUTY_SAW(132),PWM_DUTY_SAW(133),PWM_DUTY_SAW(134),PWM_DUTY_SAW(135),PWM_DUTY_SAW(136),PWM_DUTY_SAW(137),PWM_DUTY_SAW(138),PWM_DUTY_SAW(139),PWM_DUTY_SAW(140),PWM_DUTY_SAW(141),PWM_DUTY_SAW(142),PWM_DUTY_SAW(143),PWM_DUTY_SAW(144),PWM_DUTY_SAW(145),PWM_DUTY_SAW(146),PWM_DUTY_SAW(147),PWM_DUTY_SAW(148),PWM_DUTY_SAW(149),PWM_DUTY_SAW(150),PWM_DUTY_SAW(151),PWM_DUTY_SAW(152),PWM_DUTY_SAW(153),PWM_DUTY_SAW(154),PWM_DUTY_SAW(155),PWM_DUTY_SAW(156),PWM_DUTY_SAW(157),PWM_DUTY_SAW(158),PWM_DUTY_SAW(159),PWM_DUTY_SAW(160),PWM_DUTY_SAW(161),PWM_DUTY_SAW(162),PWM_DUTY_SAW(163),PWM_DUTY_SAW(164),PWM_DUTY_SAW(165),PWM_DUTY_SAW(166),PWM_DUTY_SAW(167),PWM_DUTY_SAW(168),PWM_DUTY_SAW(169),PWM_DUTY_SAW(170),PWM_DUTY_SAW(171),PWM_DUTY_SAW(172),PWM_DUTY_SAW(173),PWM_DUTY_SAW(174),PWM_DUTY_SAW(175),PWM_DUTY_SAW(176),PWM_DUTY_SAW(177),PWM_DUTY_SAW(178),PWM_DUTY_SAW(179),PWM_DUTY_SAW(180),PWM_DUTY_SAW(181),PWM_DUTY_SAW(182),PWM_DUTY_SAW(183),PWM_DUTY_SAW(184),PWM_DUTY_SAW(185),PWM_DUTY_SAW(186),PWM_DUTY_SAW(187),PWM_DUTY_SAW(188),PWM_DUTY_SAW(189),PWM_DUTY_SAW(190),PWM_DUTY_SAW(191),PWM_DUTY_SAW(192),PWM_DUTY_SAW(193),PWM_DUTY_SAW(194),PWM_DUTY_SAW(195),PWM_DUTY_SAW(196),PWM_DUTY_SAW(197),PWM_DUTY_SAW(198),PWM_DUTY_SAW(199),PWM_DUTY_SAW(200),PWM_DUTY_SAW(201),PWM_DUTY_SAW(202),PWM_DUTY_SAW(203),PWM_DUTY_SAW(204),PWM_DUTY_SAW(205),PWM_DUTY_SAW(206),PWM_DUTY_SAW(207),PWM_DUTY_SAW(208),PWM_DUTY_SAW(209),PWM_DUTY_SAW(210),PWM_DUTY_SAW(211),PWM_DUTY_SAW(212),PWM_DUTY_SAW(213),PWM_DUTY_SAW(214),PWM_DUTY_SAW(215),PWM_DUTY_SAW(216),PWM_DUTY_SAW(217),PWM_DUTY_SAW(218),PWM_DUTY_SAW(219),PWM_DUTY_SAW(220),PWM_DUTY_SAW(221),PWM_DUTY_SAW(222),PWM_DUTY_SAW(223),PWM_DUTY_SAW(224),PWM_DUTY_SAW(225),PWM_DUTY_SAW(226),PWM_DUTY_SAW(227),PWM_DUTY_SAW(228),PWM_DUTY_SAW(229),PWM_DUTY_SAW(230),PWM_DUTY_SAW(231),PWM_DUTY_SAW(232),PWM_DUTY_SAW(233),PWM_DUTY_SAW(234),PWM_DUTY_SAW(235),PWM_DUTY_SAW(236),PWM_DUTY_SAW(237),PWM_DUTY_SAW(238),PWM_DUTY_SAW(239),PWM_DUTY_SAW(240),PWM_DUTY_SAW(241),PWM_DUTY_SAW(242),PWM_DUTY_SAW(243),PWM_DUTY_SAW(244),PWM_DUTY_SAW(245),PWM_DUTY_SAW(246),PWM_DUTY_SAW(247),PWM_DUTY_SAW(248),PWM_DUTY_SAW(249),PWM_DUTY_SAW(250),PWM_DUTY_SAW(251),PWM_DUTY_SAW(252),PWM_DUTY_SAW(253),PWM_DUTY_SAW(254),PWM_DUTY_SAW(255)};
 __attribute__ ((aligned (256))) volatile constexpr PROGMEM const int8_t triangularSampling[]={PWM_DUTY_TRIANGULAR(0),PWM_DUTY_TRIANGULAR(1),PWM_DUTY_TRIANGULAR(2),PWM_DUTY_TRIANGULAR(3),PWM_DUTY_TRIANGULAR(4),PWM_DUTY_TRIANGULAR(5),PWM_DUTY_TRIANGULAR(6),PWM_DUTY_TRIANGULAR(7),PWM_DUTY_TRIANGULAR(8),PWM_DUTY_TRIANGULAR(9),PWM_DUTY_TRIANGULAR(10),PWM_DUTY_TRIANGULAR(11),PWM_DUTY_TRIANGULAR(12),PWM_DUTY_TRIANGULAR(13),PWM_DUTY_TRIANGULAR(14),PWM_DUTY_TRIANGULAR(15),PWM_DUTY_TRIANGULAR(16),PWM_DUTY_TRIANGULAR(17),PWM_DUTY_TRIANGULAR(18),PWM_DUTY_TRIANGULAR(19),PWM_DUTY_TRIANGULAR(20),PWM_DUTY_TRIANGULAR(21),PWM_DUTY_TRIANGULAR(22),PWM_DUTY_TRIANGULAR(23),PWM_DUTY_TRIANGULAR(24),PWM_DUTY_TRIANGULAR(25),PWM_DUTY_TRIANGULAR(26),PWM_DUTY_TRIANGULAR(27),PWM_DUTY_TRIANGULAR(28),PWM_DUTY_TRIANGULAR(29),PWM_DUTY_TRIANGULAR(30),PWM_DUTY_TRIANGULAR(31),PWM_DUTY_TRIANGULAR(32),PWM_DUTY_TRIANGULAR(33),PWM_DUTY_TRIANGULAR(34),PWM_DUTY_TRIANGULAR(35),PWM_DUTY_TRIANGULAR(36),PWM_DUTY_TRIANGULAR(37),PWM_DUTY_TRIANGULAR(38),PWM_DUTY_TRIANGULAR(39),PWM_DUTY_TRIANGULAR(40),PWM_DUTY_TRIANGULAR(41),PWM_DUTY_TRIANGULAR(42),PWM_DUTY_TRIANGULAR(43),PWM_DUTY_TRIANGULAR(44),PWM_DUTY_TRIANGULAR(45),PWM_DUTY_TRIANGULAR(46),PWM_DUTY_TRIANGULAR(47),PWM_DUTY_TRIANGULAR(48),PWM_DUTY_TRIANGULAR(49),PWM_DUTY_TRIANGULAR(50),PWM_DUTY_TRIANGULAR(51),PWM_DUTY_TRIANGULAR(52),PWM_DUTY_TRIANGULAR(53),PWM_DUTY_TRIANGULAR(54),PWM_DUTY_TRIANGULAR(55),PWM_DUTY_TRIANGULAR(56),PWM_DUTY_TRIANGULAR(57),PWM_DUTY_TRIANGULAR(58),PWM_DUTY_TRIANGULAR(59),PWM_DUTY_TRIANGULAR(60),PWM_DUTY_TRIANGULAR(61),PWM_DUTY_TRIANGULAR(62),PWM_DUTY_TRIANGULAR(63),PWM_DUTY_TRIANGULAR(64),PWM_DUTY_TRIANGULAR(65),PWM_DUTY_TRIANGULAR(66),PWM_DUTY_TRIANGULAR(67),PWM_DUTY_TRIANGULAR(68),PWM_DUTY_TRIANGULAR(69),PWM_DUTY_TRIANGULAR(70),PWM_DUTY_TRIANGULAR(71),PWM_DUTY_TRIANGULAR(72),PWM_DUTY_TRIANGULAR(73),PWM_DUTY_TRIANGULAR(74),PWM_DUTY_TRIANGULAR(75),PWM_DUTY_TRIANGULAR(76),PWM_DUTY_TRIANGULAR(77),PWM_DUTY_TRIANGULAR(78),PWM_DUTY_TRIANGULAR(79),PWM_DUTY_TRIANGULAR(80),PWM_DUTY_TRIANGULAR(81),PWM_DUTY_TRIANGULAR(82),PWM_DUTY_TRIANGULAR(83),PWM_DUTY_TRIANGULAR(84),PWM_DUTY_TRIANGULAR(85),PWM_DUTY_TRIANGULAR(86),PWM_DUTY_TRIANGULAR(87),PWM_DUTY_TRIANGULAR(88),PWM_DUTY_TRIANGULAR(89),PWM_DUTY_TRIANGULAR(90),PWM_DUTY_TRIANGULAR(91),PWM_DUTY_TRIANGULAR(92),PWM_DUTY_TRIANGULAR(93),PWM_DUTY_TRIANGULAR(94),PWM_DUTY_TRIANGULAR(95),PWM_DUTY_TRIANGULAR(96),PWM_DUTY_TRIANGULAR(97),PWM_DUTY_TRIANGULAR(98),PWM_DUTY_TRIANGULAR(99),PWM_DUTY_TRIANGULAR(100),PWM_DUTY_TRIANGULAR(101),PWM_DUTY_TRIANGULAR(102),PWM_DUTY_TRIANGULAR(103),PWM_DUTY_TRIANGULAR(104),PWM_DUTY_TRIANGULAR(105),PWM_DUTY_TRIANGULAR(106),PWM_DUTY_TRIANGULAR(107),PWM_DUTY_TRIANGULAR(108),PWM_DUTY_TRIANGULAR(109),PWM_DUTY_TRIANGULAR(110),PWM_DUTY_TRIANGULAR(111),PWM_DUTY_TRIANGULAR(112),PWM_DUTY_TRIANGULAR(113),PWM_DUTY_TRIANGULAR(114),PWM_DUTY_TRIANGULAR(115),PWM_DUTY_TRIANGULAR(116),PWM_DUTY_TRIANGULAR(117),PWM_DUTY_TRIANGULAR(118),PWM_DUTY_TRIANGULAR(119),PWM_DUTY_TRIANGULAR(120),PWM_DUTY_TRIANGULAR(121),PWM_DUTY_TRIANGULAR(122),PWM_DUTY_TRIANGULAR(123),PWM_DUTY_TRIANGULAR(124),PWM_DUTY_TRIANGULAR(125),PWM_DUTY_TRIANGULAR(126),PWM_DUTY_TRIANGULAR(127),PWM_DUTY_TRIANGULAR(128),PWM_DUTY_TRIANGULAR(129),PWM_DUTY_TRIANGULAR(130),PWM_DUTY_TRIANGULAR(131),PWM_DUTY_TRIANGULAR(132),PWM_DUTY_TRIANGULAR(133),PWM_DUTY_TRIANGULAR(134),PWM_DUTY_TRIANGULAR(135),PWM_DUTY_TRIANGULAR(136),PWM_DUTY_TRIANGULAR(137),PWM_DUTY_TRIANGULAR(138),PWM_DUTY_TRIANGULAR(139),PWM_DUTY_TRIANGULAR(140),PWM_DUTY_TRIANGULAR(141),PWM_DUTY_TRIANGULAR(142),PWM_DUTY_TRIANGULAR(143),PWM_DUTY_TRIANGULAR(144),PWM_DUTY_TRIANGULAR(145),PWM_DUTY_TRIANGULAR(146),PWM_DUTY_TRIANGULAR(147),PWM_DUTY_TRIANGULAR(148),PWM_DUTY_TRIANGULAR(149),PWM_DUTY_TRIANGULAR(150),PWM_DUTY_TRIANGULAR(151),PWM_DUTY_TRIANGULAR(152),PWM_DUTY_TRIANGULAR(153),PWM_DUTY_TRIANGULAR(154),PWM_DUTY_TRIANGULAR(155),PWM_DUTY_TRIANGULAR(156),PWM_DUTY_TRIANGULAR(157),PWM_DUTY_TRIANGULAR(158),PWM_DUTY_TRIANGULAR(159),PWM_DUTY_TRIANGULAR(160),PWM_DUTY_TRIANGULAR(161),PWM_DUTY_TRIANGULAR(162),PWM_DUTY_TRIANGULAR(163),PWM_DUTY_TRIANGULAR(164),PWM_DUTY_TRIANGULAR(165),PWM_DUTY_TRIANGULAR(166),PWM_DUTY_TRIANGULAR(167),PWM_DUTY_TRIANGULAR(168),PWM_DUTY_TRIANGULAR(169),PWM_DUTY_TRIANGULAR(170),PWM_DUTY_TRIANGULAR(171),PWM_DUTY_TRIANGULAR(172),PWM_DUTY_TRIANGULAR(173),PWM_DUTY_TRIANGULAR(174),PWM_DUTY_TRIANGULAR(175),PWM_DUTY_TRIANGULAR(176),PWM_DUTY_TRIANGULAR(177),PWM_DUTY_TRIANGULAR(178),PWM_DUTY_TRIANGULAR(179),PWM_DUTY_TRIANGULAR(180),PWM_DUTY_TRIANGULAR(181),PWM_DUTY_TRIANGULAR(182),PWM_DUTY_TRIANGULAR(183),PWM_DUTY_TRIANGULAR(184),PWM_DUTY_TRIANGULAR(185),PWM_DUTY_TRIANGULAR(186),PWM_DUTY_TRIANGULAR(187),PWM_DUTY_TRIANGULAR(188),PWM_DUTY_TRIANGULAR(189),PWM_DUTY_TRIANGULAR(190),PWM_DUTY_TRIANGULAR(191),PWM_DUTY_TRIANGULAR(192),PWM_DUTY_TRIANGULAR(193),PWM_DUTY_TRIANGULAR(194),PWM_DUTY_TRIANGULAR(195),PWM_DUTY_TRIANGULAR(196),PWM_DUTY_TRIANGULAR(197),PWM_DUTY_TRIANGULAR(198),PWM_DUTY_TRIANGULAR(199),PWM_DUTY_TRIANGULAR(200),PWM_DUTY_TRIANGULAR(201),PWM_DUTY_TRIANGULAR(202),PWM_DUTY_TRIANGULAR(203),PWM_DUTY_TRIANGULAR(204),PWM_DUTY_TRIANGULAR(205),PWM_DUTY_TRIANGULAR(206),PWM_DUTY_TRIANGULAR(207),PWM_DUTY_TRIANGULAR(208),PWM_DUTY_TRIANGULAR(209),PWM_DUTY_TRIANGULAR(210),PWM_DUTY_TRIANGULAR(211),PWM_DUTY_TRIANGULAR(212),PWM_DUTY_TRIANGULAR(213),PWM_DUTY_TRIANGULAR(214),PWM_DUTY_TRIANGULAR(215),PWM_DUTY_TRIANGULAR(216),PWM_DUTY_TRIANGULAR(217),PWM_DUTY_TRIANGULAR(218),PWM_DUTY_TRIANGULAR(219),PWM_DUTY_TRIANGULAR(220),PWM_DUTY_TRIANGULAR(221),PWM_DUTY_TRIANGULAR(222),PWM_DUTY_TRIANGULAR(223),PWM_DUTY_TRIANGULAR(224),PWM_DUTY_TRIANGULAR(225),PWM_DUTY_TRIANGULAR(226),PWM_DUTY_TRIANGULAR(227),PWM_DUTY_TRIANGULAR(228),PWM_DUTY_TRIANGULAR(229),PWM_DUTY_TRIANGULAR(230),PWM_DUTY_TRIANGULAR(231),PWM_DUTY_TRIANGULAR(232),PWM_DUTY_TRIANGULAR(233),PWM_DUTY_TRIANGULAR(234),PWM_DUTY_TRIANGULAR(235),PWM_DUTY_TRIANGULAR(236),PWM_DUTY_TRIANGULAR(237),PWM_DUTY_TRIANGULAR(238),PWM_DUTY_TRIANGULAR(239),PWM_DUTY_TRIANGULAR(240),PWM_DUTY_TRIANGULAR(241),PWM_DUTY_TRIANGULAR(242),PWM_DUTY_TRIANGULAR(243),PWM_DUTY_TRIANGULAR(244),PWM_DUTY_TRIANGULAR(245),PWM_DUTY_TRIANGULAR(246),PWM_DUTY_TRIANGULAR(247),PWM_DUTY_TRIANGULAR(248),PWM_DUTY_TRIANGULAR(249),PWM_DUTY_TRIANGULAR(250),PWM_DUTY_TRIANGULAR(251),PWM_DUTY_TRIANGULAR(252),PWM_DUTY_TRIANGULAR(253),PWM_DUTY_TRIANGULAR(254),PWM_DUTY_TRIANGULAR(255)};
 __attribute__ ((aligned (256))) volatile constexpr PROGMEM const int8_t rectangularSampling12_5[]={PWM_DUTY_RECTANGULAR12_5(0),PWM_DUTY_RECTANGULAR12_5(1),PWM_DUTY_RECTANGULAR12_5(2),PWM_DUTY_RECTANGULAR12_5(3),PWM_DUTY_RECTANGULAR12_5(4),PWM_DUTY_RECTANGULAR12_5(5),PWM_DUTY_RECTANGULAR12_5(6),PWM_DUTY_RECTANGULAR12_5(7),PWM_DUTY_RECTANGULAR12_5(8),PWM_DUTY_RECTANGULAR12_5(9),PWM_DUTY_RECTANGULAR12_5(10),PWM_DUTY_RECTANGULAR12_5(11),PWM_DUTY_RECTANGULAR12_5(12),PWM_DUTY_RECTANGULAR12_5(13),PWM_DUTY_RECTANGULAR12_5(14),PWM_DUTY_RECTANGULAR12_5(15),PWM_DUTY_RECTANGULAR12_5(16),PWM_DUTY_RECTANGULAR12_5(17),PWM_DUTY_RECTANGULAR12_5(18),PWM_DUTY_RECTANGULAR12_5(19),PWM_DUTY_RECTANGULAR12_5(20),PWM_DUTY_RECTANGULAR12_5(21),PWM_DUTY_RECTANGULAR12_5(22),PWM_DUTY_RECTANGULAR12_5(23),PWM_DUTY_RECTANGULAR12_5(24),PWM_DUTY_RECTANGULAR12_5(25),PWM_DUTY_RECTANGULAR12_5(26),PWM_DUTY_RECTANGULAR12_5(27),PWM_DUTY_RECTANGULAR12_5(28),PWM_DUTY_RECTANGULAR12_5(29),PWM_DUTY_RECTANGULAR12_5(30),PWM_DUTY_RECTANGULAR12_5(31),PWM_DUTY_RECTANGULAR12_5(32),PWM_DUTY_RECTANGULAR12_5(33),PWM_DUTY_RECTANGULAR12_5(34),PWM_DUTY_RECTANGULAR12_5(35),PWM_DUTY_RECTANGULAR12_5(36),PWM_DUTY_RECTANGULAR12_5(37),PWM_DUTY_RECTANGULAR12_5(38),PWM_DUTY_RECTANGULAR12_5(39),PWM_DUTY_RECTANGULAR12_5(40),PWM_DUTY_RECTANGULAR12_5(41),PWM_DUTY_RECTANGULAR12_5(42),PWM_DUTY_RECTANGULAR12_5(43),PWM_DUTY_RECTANGULAR12_5(44),PWM_DUTY_RECTANGULAR12_5(45),PWM_DUTY_RECTANGULAR12_5(46),PWM_DUTY_RECTANGULAR12_5(47),PWM_DUTY_RECTANGULAR12_5(48),PWM_DUTY_RECTANGULAR12_5(49),PWM_DUTY_RECTANGULAR12_5(50),PWM_DUTY_RECTANGULAR12_5(51),PWM_DUTY_RECTANGULAR12_5(52),PWM_DUTY_RECTANGULAR12_5(53),PWM_DUTY_RECTANGULAR12_5(54),PWM_DUTY_RECTANGULAR12_5(55),PWM_DUTY_RECTANGULAR12_5(56),PWM_DUTY_RECTANGULAR12_5(57),PWM_DUTY_RECTANGULAR12_5(58),PWM_DUTY_RECTANGULAR12_5(59),PWM_DUTY_RECTANGULAR12_5(60),PWM_DUTY_RECTANGULAR12_5(61),PWM_DUTY_RECTANGULAR12_5(62),PWM_DUTY_RECTANGULAR12_5(63),PWM_DUTY_RECTANGULAR12_5(64),PWM_DUTY_RECTANGULAR12_5(65),PWM_DUTY_RECTANGULAR12_5(66),PWM_DUTY_RECTANGULAR12_5(67),PWM_DUTY_RECTANGULAR12_5(68),PWM_DUTY_RECTANGULAR12_5(69),PWM_DUTY_RECTANGULAR12_5(70),PWM_DUTY_RECTANGULAR12_5(71),PWM_DUTY_RECTANGULAR12_5(72),PWM_DUTY_RECTANGULAR12_5(73),PWM_DUTY_RECTANGULAR12_5(74),PWM_DUTY_RECTANGULAR12_5(75),PWM_DUTY_RECTANGULAR12_5(76),PWM_DUTY_RECTANGULAR12_5(77),PWM_DUTY_RECTANGULAR12_5(78),PWM_DUTY_RECTANGULAR12_5(79),PWM_DUTY_RECTANGULAR12_5(80),PWM_DUTY_RECTANGULAR12_5(81),PWM_DUTY_RECTANGULAR12_5(82),PWM_DUTY_RECTANGULAR12_5(83),PWM_DUTY_RECTANGULAR12_5(84),PWM_DUTY_RECTANGULAR12_5(85),PWM_DUTY_RECTANGULAR12_5(86),PWM_DUTY_RECTANGULAR12_5(87),PWM_DUTY_RECTANGULAR12_5(88),PWM_DUTY_RECTANGULAR12_5(89),PWM_DUTY_RECTANGULAR12_5(90),PWM_DUTY_RECTANGULAR12_5(91),PWM_DUTY_RECTANGULAR12_5(92),PWM_DUTY_RECTANGULAR12_5(93),PWM_DUTY_RECTANGULAR12_5(94),PWM_DUTY_RECTANGULAR12_5(95),PWM_DUTY_RECTANGULAR12_5(96),PWM_DUTY_RECTANGULAR12_5(97),PWM_DUTY_RECTANGULAR12_5(98),PWM_DUTY_RECTANGULAR12_5(99),PWM_DUTY_RECTANGULAR12_5(100),PWM_DUTY_RECTANGULAR12_5(101),PWM_DUTY_RECTANGULAR12_5(102),PWM_DUTY_RECTANGULAR12_5(103),PWM_DUTY_RECTANGULAR12_5(104),PWM_DUTY_RECTANGULAR12_5(105),PWM_DUTY_RECTANGULAR12_5(106),PWM_DUTY_RECTANGULAR12_5(107),PWM_DUTY_RECTANGULAR12_5(108),PWM_DUTY_RECTANGULAR12_5(109),PWM_DUTY_RECTANGULAR12_5(110),PWM_DUTY_RECTANGULAR12_5(111),PWM_DUTY_RECTANGULAR12_5(112),PWM_DUTY_RECTANGULAR12_5(113),PWM_DUTY_RECTANGULAR12_5(114),PWM_DUTY_RECTANGULAR12_5(115),PWM_DUTY_RECTANGULAR12_5(116),PWM_DUTY_RECTANGULAR12_5(117),PWM_DUTY_RECTANGULAR12_5(118),PWM_DUTY_RECTANGULAR12_5(119),PWM_DUTY_RECTANGULAR12_5(120),PWM_DUTY_RECTANGULAR12_5(121),PWM_DUTY_RECTANGULAR12_5(122),PWM_DUTY_RECTANGULAR12_5(123),PWM_DUTY_RECTANGULAR12_5(124),PWM_DUTY_RECTANGULAR12_5(125),PWM_DUTY_RECTANGULAR12_5(126),PWM_DUTY_RECTANGULAR12_5(127),PWM_DUTY_RECTANGULAR12_5(128),PWM_DUTY_RECTANGULAR12_5(129),PWM_DUTY_RECTANGULAR12_5(130),PWM_DUTY_RECTANGULAR12_5(131),PWM_DUTY_RECTANGULAR12_5(132),PWM_DUTY_RECTANGULAR12_5(133),PWM_DUTY_RECTANGULAR12_5(134),PWM_DUTY_RECTANGULAR12_5(135),PWM_DUTY_RECTANGULAR12_5(136),PWM_DUTY_RECTANGULAR12_5(137),PWM_DUTY_RECTANGULAR12_5(138),PWM_DUTY_RECTANGULAR12_5(139),PWM_DUTY_RECTANGULAR12_5(140),PWM_DUTY_RECTANGULAR12_5(141),PWM_DUTY_RECTANGULAR12_5(142),PWM_DUTY_RECTANGULAR12_5(143),PWM_DUTY_RECTANGULAR12_5(144),PWM_DUTY_RECTANGULAR12_5(145),PWM_DUTY_RECTANGULAR12_5(146),PWM_DUTY_RECTANGULAR12_5(147),PWM_DUTY_RECTANGULAR12_5(148),PWM_DUTY_RECTANGULAR12_5(149),PWM_DUTY_RECTANGULAR12_5(150),PWM_DUTY_RECTANGULAR12_5(151),PWM_DUTY_RECTANGULAR12_5(152),PWM_DUTY_RECTANGULAR12_5(153),PWM_DUTY_RECTANGULAR12_5(154),PWM_DUTY_RECTANGULAR12_5(155),PWM_DUTY_RECTANGULAR12_5(156),PWM_DUTY_RECTANGULAR12_5(157),PWM_DUTY_RECTANGULAR12_5(158),PWM_DUTY_RECTANGULAR12_5(159),PWM_DUTY_RECTANGULAR12_5(160),PWM_DUTY_RECTANGULAR12_5(161),PWM_DUTY_RECTANGULAR12_5(162),PWM_DUTY_RECTANGULAR12_5(163),PWM_DUTY_RECTANGULAR12_5(164),PWM_DUTY_RECTANGULAR12_5(165),PWM_DUTY_RECTANGULAR12_5(166),PWM_DUTY_RECTANGULAR12_5(167),PWM_DUTY_RECTANGULAR12_5(168),PWM_DUTY_RECTANGULAR12_5(169),PWM_DUTY_RECTANGULAR12_5(170),PWM_DUTY_RECTANGULAR12_5(171),PWM_DUTY_RECTANGULAR12_5(172),PWM_DUTY_RECTANGULAR12_5(173),PWM_DUTY_RECTANGULAR12_5(174),PWM_DUTY_RECTANGULAR12_5(175),PWM_DUTY_RECTANGULAR12_5(176),PWM_DUTY_RECTANGULAR12_5(177),PWM_DUTY_RECTANGULAR12_5(178),PWM_DUTY_RECTANGULAR12_5(179),PWM_DUTY_RECTANGULAR12_5(180),PWM_DUTY_RECTANGULAR12_5(181),PWM_DUTY_RECTANGULAR12_5(182),PWM_DUTY_RECTANGULAR12_5(183),PWM_DUTY_RECTANGULAR12_5(184),PWM_DUTY_RECTANGULAR12_5(185),PWM_DUTY_RECTANGULAR12_5(186),PWM_DUTY_RECTANGULAR12_5(187),PWM_DUTY_RECTANGULAR12_5(188),PWM_DUTY_RECTANGULAR12_5(189),PWM_DUTY_RECTANGULAR12_5(190),PWM_DUTY_RECTANGULAR12_5(191),PWM_DUTY_RECTANGULAR12_5(192),PWM_DUTY_RECTANGULAR12_5(193),PWM_DUTY_RECTANGULAR12_5(194),PWM_DUTY_RECTANGULAR12_5(195),PWM_DUTY_RECTANGULAR12_5(196),PWM_DUTY_RECTANGULAR12_5(197),PWM_DUTY_RECTANGULAR12_5(198),PWM_DUTY_RECTANGULAR12_5(199),PWM_DUTY_RECTANGULAR12_5(200),PWM_DUTY_RECTANGULAR12_5(201),PWM_DUTY_RECTANGULAR12_5(202),PWM_DUTY_RECTANGULAR12_5(203),PWM_DUTY_RECTANGULAR12_5(204),PWM_DUTY_RECTANGULAR12_5(205),PWM_DUTY_RECTANGULAR12_5(206),PWM_DUTY_RECTANGULAR12_5(207),PWM_DUTY_RECTANGULAR12_5(208),PWM_DUTY_RECTANGULAR12_5(209),PWM_DUTY_RECTANGULAR12_5(210),PWM_DUTY_RECTANGULAR12_5(211),PWM_DUTY_RECTANGULAR12_5(212),PWM_DUTY_RECTANGULAR12_5(213),PWM_DUTY_RECTANGULAR12_5(214),PWM_DUTY_RECTANGULAR12_5(215),PWM_DUTY_RECTANGULAR12_5(216),PWM_DUTY_RECTANGULAR12_5(217),PWM_DUTY_RECTANGULAR12_5(218),PWM_DUTY_RECTANGULAR12_5(219),PWM_DUTY_RECTANGULAR12_5(220),PWM_DUTY_RECTANGULAR12_5(221),PWM_DUTY_RECTANGULAR12_5(222),PWM_DUTY_RECTANGULAR12_5(223),PWM_DUTY_RECTANGULAR12_5(224),PWM_DUTY_RECTANGULAR12_5(225),PWM_DUTY_RECTANGULAR12_5(226),PWM_DUTY_RECTANGULAR12_5(227),PWM_DUTY_RECTANGULAR12_5(228),PWM_DUTY_RECTANGULAR12_5(229),PWM_DUTY_RECTANGULAR12_5(230),PWM_DUTY_RECTANGULAR12_5(231),PWM_DUTY_RECTANGULAR12_5(232),PWM_DUTY_RECTANGULAR12_5(233),PWM_DUTY_RECTANGULAR12_5(234),PWM_DUTY_RECTANGULAR12_5(235),PWM_DUTY_RECTANGULAR12_5(236),PWM_DUTY_RECTANGULAR12_5(237),PWM_DUTY_RECTANGULAR12_5(238),PWM_DUTY_RECTANGULAR12_5(239),PWM_DUTY_RECTANGULAR12_5(240),PWM_DUTY_RECTANGULAR12_5(241),PWM_DUTY_RECTANGULAR12_5(242),PWM_DUTY_RECTANGULAR12_5(243),PWM_DUTY_RECTANGULAR12_5(244),PWM_DUTY_RECTANGULAR12_5(245),PWM_DUTY_RECTANGULAR12_5(246),PWM_DUTY_RECTANGULAR12_5(247),PWM_DUTY_RECTANGULAR12_5(248),PWM_DUTY_RECTANGULAR12_5(249),PWM_DUTY_RECTANGULAR12_5(250),PWM_DUTY_RECTANGULAR12_5(251),PWM_DUTY_RECTANGULAR12_5(252),PWM_DUTY_RECTANGULAR12_5(253),PWM_DUTY_RECTANGULAR12_5(254),PWM_DUTY_RECTANGULAR12_5(255)};
 __attribute__ ((aligned (256))) volatile constexpr PROGMEM const int8_t rectangularSampling25[]={PWM_DUTY_RECTANGULAR25(0),PWM_DUTY_RECTANGULAR25(1),PWM_DUTY_RECTANGULAR25(2),PWM_DUTY_RECTANGULAR25(3),PWM_DUTY_RECTANGULAR25(4),PWM_DUTY_RECTANGULAR25(5),PWM_DUTY_RECTANGULAR25(6),PWM_DUTY_RECTANGULAR25(7),PWM_DUTY_RECTANGULAR25(8),PWM_DUTY_RECTANGULAR25(9),PWM_DUTY_RECTANGULAR25(10),PWM_DUTY_RECTANGULAR25(11),PWM_DUTY_RECTANGULAR25(12),PWM_DUTY_RECTANGULAR25(13),PWM_DUTY_RECTANGULAR25(14),PWM_DUTY_RECTANGULAR25(15),PWM_DUTY_RECTANGULAR25(16),PWM_DUTY_RECTANGULAR25(17),PWM_DUTY_RECTANGULAR25(18),PWM_DUTY_RECTANGULAR25(19),PWM_DUTY_RECTANGULAR25(20),PWM_DUTY_RECTANGULAR25(21),PWM_DUTY_RECTANGULAR25(22),PWM_DUTY_RECTANGULAR25(23),PWM_DUTY_RECTANGULAR25(24),PWM_DUTY_RECTANGULAR25(25),PWM_DUTY_RECTANGULAR25(26),PWM_DUTY_RECTANGULAR25(27),PWM_DUTY_RECTANGULAR25(28),PWM_DUTY_RECTANGULAR25(29),PWM_DUTY_RECTANGULAR25(30),PWM_DUTY_RECTANGULAR25(31),PWM_DUTY_RECTANGULAR25(32),PWM_DUTY_RECTANGULAR25(33),PWM_DUTY_RECTANGULAR25(34),PWM_DUTY_RECTANGULAR25(35),PWM_DUTY_RECTANGULAR25(36),PWM_DUTY_RECTANGULAR25(37),PWM_DUTY_RECTANGULAR25(38),PWM_DUTY_RECTANGULAR25(39),PWM_DUTY_RECTANGULAR25(40),PWM_DUTY_RECTANGULAR25(41),PWM_DUTY_RECTANGULAR25(42),PWM_DUTY_RECTANGULAR25(43),PWM_DUTY_RECTANGULAR25(44),PWM_DUTY_RECTANGULAR25(45),PWM_DUTY_RECTANGULAR25(46),PWM_DUTY_RECTANGULAR25(47),PWM_DUTY_RECTANGULAR25(48),PWM_DUTY_RECTANGULAR25(49),PWM_DUTY_RECTANGULAR25(50),PWM_DUTY_RECTANGULAR25(51),PWM_DUTY_RECTANGULAR25(52),PWM_DUTY_RECTANGULAR25(53),PWM_DUTY_RECTANGULAR25(54),PWM_DUTY_RECTANGULAR25(55),PWM_DUTY_RECTANGULAR25(56),PWM_DUTY_RECTANGULAR25(57),PWM_DUTY_RECTANGULAR25(58),PWM_DUTY_RECTANGULAR25(59),PWM_DUTY_RECTANGULAR25(60),PWM_DUTY_RECTANGULAR25(61),PWM_DUTY_RECTANGULAR25(62),PWM_DUTY_RECTANGULAR25(63),PWM_DUTY_RECTANGULAR25(64),PWM_DUTY_RECTANGULAR25(65),PWM_DUTY_RECTANGULAR25(66),PWM_DUTY_RECTANGULAR25(67),PWM_DUTY_RECTANGULAR25(68),PWM_DUTY_RECTANGULAR25(69),PWM_DUTY_RECTANGULAR25(70),PWM_DUTY_RECTANGULAR25(71),PWM_DUTY_RECTANGULAR25(72),PWM_DUTY_RECTANGULAR25(73),PWM_DUTY_RECTANGULAR25(74),PWM_DUTY_RECTANGULAR25(75),PWM_DUTY_RECTANGULAR25(76),PWM_DUTY_RECTANGULAR25(77),PWM_DUTY_RECTANGULAR25(78),PWM_DUTY_RECTANGULAR25(79),PWM_DUTY_RECTANGULAR25(80),PWM_DUTY_RECTANGULAR25(81),PWM_DUTY_RECTANGULAR25(82),PWM_DUTY_RECTANGULAR25(83),PWM_DUTY_RECTANGULAR25(84),PWM_DUTY_RECTANGULAR25(85),PWM_DUTY_RECTANGULAR25(86),PWM_DUTY_RECTANGULAR25(87),PWM_DUTY_RECTANGULAR25(88),PWM_DUTY_RECTANGULAR25(89),PWM_DUTY_RECTANGULAR25(90),PWM_DUTY_RECTANGULAR25(91),PWM_DUTY_RECTANGULAR25(92),PWM_DUTY_RECTANGULAR25(93),PWM_DUTY_RECTANGULAR25(94),PWM_DUTY_RECTANGULAR25(95),PWM_DUTY_RECTANGULAR25(96),PWM_DUTY_RECTANGULAR25(97),PWM_DUTY_RECTANGULAR25(98),PWM_DUTY_RECTANGULAR25(99),PWM_DUTY_RECTANGULAR25(100),PWM_DUTY_RECTANGULAR25(101),PWM_DUTY_RECTANGULAR25(102),PWM_DUTY_RECTANGULAR25(103),PWM_DUTY_RECTANGULAR25(104),PWM_DUTY_RECTANGULAR25(105),PWM_DUTY_RECTANGULAR25(106),PWM_DUTY_RECTANGULAR25(107),PWM_DUTY_RECTANGULAR25(108),PWM_DUTY_RECTANGULAR25(109),PWM_DUTY_RECTANGULAR25(110),PWM_DUTY_RECTANGULAR25(111),PWM_DUTY_RECTANGULAR25(112),PWM_DUTY_RECTANGULAR25(113),PWM_DUTY_RECTANGULAR25(114),PWM_DUTY_RECTANGULAR25(115),PWM_DUTY_RECTANGULAR25(116),PWM_DUTY_RECTANGULAR25(117),PWM_DUTY_RECTANGULAR25(118),PWM_DUTY_RECTANGULAR25(119),PWM_DUTY_RECTANGULAR25(120),PWM_DUTY_RECTANGULAR25(121),PWM_DUTY_RECTANGULAR25(122),PWM_DUTY_RECTANGULAR25(123),PWM_DUTY_RECTANGULAR25(124),PWM_DUTY_RECTANGULAR25(125),PWM_DUTY_RECTANGULAR25(126),PWM_DUTY_RECTANGULAR25(127),PWM_DUTY_RECTANGULAR25(128),PWM_DUTY_RECTANGULAR25(129),PWM_DUTY_RECTANGULAR25(130),PWM_DUTY_RECTANGULAR25(131),PWM_DUTY_RECTANGULAR25(132),PWM_DUTY_RECTANGULAR25(133),PWM_DUTY_RECTANGULAR25(134),PWM_DUTY_RECTANGULAR25(135),PWM_DUTY_RECTANGULAR25(136),PWM_DUTY_RECTANGULAR25(137),PWM_DUTY_RECTANGULAR25(138),PWM_DUTY_RECTANGULAR25(139),PWM_DUTY_RECTANGULAR25(140),PWM_DUTY_RECTANGULAR25(141),PWM_DUTY_RECTANGULAR25(142),PWM_DUTY_RECTANGULAR25(143),PWM_DUTY_RECTANGULAR25(144),PWM_DUTY_RECTANGULAR25(145),PWM_DUTY_RECTANGULAR25(146),PWM_DUTY_RECTANGULAR25(147),PWM_DUTY_RECTANGULAR25(148),PWM_DUTY_RECTANGULAR25(149),PWM_DUTY_RECTANGULAR25(150),PWM_DUTY_RECTANGULAR25(151),PWM_DUTY_RECTANGULAR25(152),PWM_DUTY_RECTANGULAR25(153),PWM_DUTY_RECTANGULAR25(154),PWM_DUTY_RECTANGULAR25(155),PWM_DUTY_RECTANGULAR25(156),PWM_DUTY_RECTANGULAR25(157),PWM_DUTY_RECTANGULAR25(158),PWM_DUTY_RECTANGULAR25(159),PWM_DUTY_RECTANGULAR25(160),PWM_DUTY_RECTANGULAR25(161),PWM_DUTY_RECTANGULAR25(162),PWM_DUTY_RECTANGULAR25(163),PWM_DUTY_RECTANGULAR25(164),PWM_DUTY_RECTANGULAR25(165),PWM_DUTY_RECTANGULAR25(166),PWM_DUTY_RECTANGULAR25(167),PWM_DUTY_RECTANGULAR25(168),PWM_DUTY_RECTANGULAR25(169),PWM_DUTY_RECTANGULAR25(170),PWM_DUTY_RECTANGULAR25(171),PWM_DUTY_RECTANGULAR25(172),PWM_DUTY_RECTANGULAR25(173),PWM_DUTY_RECTANGULAR25(174),PWM_DUTY_RECTANGULAR25(175),PWM_DUTY_RECTANGULAR25(176),PWM_DUTY_RECTANGULAR25(177),PWM_DUTY_RECTANGULAR25(178),PWM_DUTY_RECTANGULAR25(179),PWM_DUTY_RECTANGULAR25(180),PWM_DUTY_RECTANGULAR25(181),PWM_DUTY_RECTANGULAR25(182),PWM_DUTY_RECTANGULAR25(183),PWM_DUTY_RECTANGULAR25(184),PWM_DUTY_RECTANGULAR25(185),PWM_DUTY_RECTANGULAR25(186),PWM_DUTY_RECTANGULAR25(187),PWM_DUTY_RECTANGULAR25(188),PWM_DUTY_RECTANGULAR25(189),PWM_DUTY_RECTANGULAR25(190),PWM_DUTY_RECTANGULAR25(191),PWM_DUTY_RECTANGULAR25(192),PWM_DUTY_RECTANGULAR25(193),PWM_DUTY_RECTANGULAR25(194),PWM_DUTY_RECTANGULAR25(195),PWM_DUTY_RECTANGULAR25(196),PWM_DUTY_RECTANGULAR25(197),PWM_DUTY_RECTANGULAR25(198),PWM_DUTY_RECTANGULAR25(199),PWM_DUTY_RECTANGULAR25(200),PWM_DUTY_RECTANGULAR25(201),PWM_DUTY_RECTANGULAR25(202),PWM_DUTY_RECTANGULAR25(203),PWM_DUTY_RECTANGULAR25(204),PWM_DUTY_RECTANGULAR25(205),PWM_DUTY_RECTANGULAR25(206),PWM_DUTY_RECTANGULAR25(207),PWM_DUTY_RECTANGULAR25(208),PWM_DUTY_RECTANGULAR25(209),PWM_DUTY_RECTANGULAR25(210),PWM_DUTY_RECTANGULAR25(211),PWM_DUTY_RECTANGULAR25(212),PWM_DUTY_RECTANGULAR25(213),PWM_DUTY_RECTANGULAR25(214),PWM_DUTY_RECTANGULAR25(215),PWM_DUTY_RECTANGULAR25(216),PWM_DUTY_RECTANGULAR25(217),PWM_DUTY_RECTANGULAR25(218),PWM_DUTY_RECTANGULAR25(219),PWM_DUTY_RECTANGULAR25(220),PWM_DUTY_RECTANGULAR25(221),PWM_DUTY_RECTANGULAR25(222),PWM_DUTY_RECTANGULAR25(223),PWM_DUTY_RECTANGULAR25(224),PWM_DUTY_RECTANGULAR25(225),PWM_DUTY_RECTANGULAR25(226),PWM_DUTY_RECTANGULAR25(227),PWM_DUTY_RECTANGULAR25(228),PWM_DUTY_RECTANGULAR25(229),PWM_DUTY_RECTANGULAR25(230),PWM_DUTY_RECTANGULAR25(231),PWM_DUTY_RECTANGULAR25(232),PWM_DUTY_RECTANGULAR25(233),PWM_DUTY_RECTANGULAR25(234),PWM_DUTY_RECTANGULAR25(235),PWM_DUTY_RECTANGULAR25(236),PWM_DUTY_RECTANGULAR25(237),PWM_DUTY_RECTANGULAR25(238),PWM_DUTY_RECTANGULAR25(239),PWM_DUTY_RECTANGULAR25(240),PWM_DUTY_RECTANGULAR25(241),PWM_DUTY_RECTANGULAR25(242),PWM_DUTY_RECTANGULAR25(243),PWM_DUTY_RECTANGULAR25(244),PWM_DUTY_RECTANGULAR25(245),PWM_DUTY_RECTANGULAR25(246),PWM_DUTY_RECTANGULAR25(247),PWM_DUTY_RECTANGULAR25(248),PWM_DUTY_RECTANGULAR25(249),PWM_DUTY_RECTANGULAR25(250),PWM_DUTY_RECTANGULAR25(251),PWM_DUTY_RECTANGULAR25(252),PWM_DUTY_RECTANGULAR25(253),PWM_DUTY_RECTANGULAR25(254),PWM_DUTY_RECTANGULAR25(255)};
 __attribute__ ((aligned (256))) volatile constexpr PROGMEM const int8_t rectangularSampling50[]={PWM_DUTY_RECTANGULAR50(0),PWM_DUTY_RECTANGULAR50(1),PWM_DUTY_RECTANGULAR50(2),PWM_DUTY_RECTANGULAR50(3),PWM_DUTY_RECTANGULAR50(4),PWM_DUTY_RECTANGULAR50(5),PWM_DUTY_RECTANGULAR50(6),PWM_DUTY_RECTANGULAR50(7),PWM_DUTY_RECTANGULAR50(8),PWM_DUTY_RECTANGULAR50(9),PWM_DUTY_RECTANGULAR50(10),PWM_DUTY_RECTANGULAR50(11),PWM_DUTY_RECTANGULAR50(12),PWM_DUTY_RECTANGULAR50(13),PWM_DUTY_RECTANGULAR50(14),PWM_DUTY_RECTANGULAR50(15),PWM_DUTY_RECTANGULAR50(16),PWM_DUTY_RECTANGULAR50(17),PWM_DUTY_RECTANGULAR50(18),PWM_DUTY_RECTANGULAR50(19),PWM_DUTY_RECTANGULAR50(20),PWM_DUTY_RECTANGULAR50(21),PWM_DUTY_RECTANGULAR50(22),PWM_DUTY_RECTANGULAR50(23),PWM_DUTY_RECTANGULAR50(24),PWM_DUTY_RECTANGULAR50(25),PWM_DUTY_RECTANGULAR50(26),PWM_DUTY_RECTANGULAR50(27),PWM_DUTY_RECTANGULAR50(28),PWM_DUTY_RECTANGULAR50(29),PWM_DUTY_RECTANGULAR50(30),PWM_DUTY_RECTANGULAR50(31),PWM_DUTY_RECTANGULAR50(32),PWM_DUTY_RECTANGULAR50(33),PWM_DUTY_RECTANGULAR50(34),PWM_DUTY_RECTANGULAR50(35),PWM_DUTY_RECTANGULAR50(36),PWM_DUTY_RECTANGULAR50(37),PWM_DUTY_RECTANGULAR50(38),PWM_DUTY_RECTANGULAR50(39),PWM_DUTY_RECTANGULAR50(40),PWM_DUTY_RECTANGULAR50(41),PWM_DUTY_RECTANGULAR50(42),PWM_DUTY_RECTANGULAR50(43),PWM_DUTY_RECTANGULAR50(44),PWM_DUTY_RECTANGULAR50(45),PWM_DUTY_RECTANGULAR50(46),PWM_DUTY_RECTANGULAR50(47),PWM_DUTY_RECTANGULAR50(48),PWM_DUTY_RECTANGULAR50(49),PWM_DUTY_RECTANGULAR50(50),PWM_DUTY_RECTANGULAR50(51),PWM_DUTY_RECTANGULAR50(52),PWM_DUTY_RECTANGULAR50(53),PWM_DUTY_RECTANGULAR50(54),PWM_DUTY_RECTANGULAR50(55),PWM_DUTY_RECTANGULAR50(56),PWM_DUTY_RECTANGULAR50(57),PWM_DUTY_RECTANGULAR50(58),PWM_DUTY_RECTANGULAR50(59),PWM_DUTY_RECTANGULAR50(60),PWM_DUTY_RECTANGULAR50(61),PWM_DUTY_RECTANGULAR50(62),PWM_DUTY_RECTANGULAR50(63),PWM_DUTY_RECTANGULAR50(64),PWM_DUTY_RECTANGULAR50(65),PWM_DUTY_RECTANGULAR50(66),PWM_DUTY_RECTANGULAR50(67),PWM_DUTY_RECTANGULAR50(68),PWM_DUTY_RECTANGULAR50(69),PWM_DUTY_RECTANGULAR50(70),PWM_DUTY_RECTANGULAR50(71),PWM_DUTY_RECTANGULAR50(72),PWM_DUTY_RECTANGULAR50(73),PWM_DUTY_RECTANGULAR50(74),PWM_DUTY_RECTANGULAR50(75),PWM_DUTY_RECTANGULAR50(76),PWM_DUTY_RECTANGULAR50(77),PWM_DUTY_RECTANGULAR50(78),PWM_DUTY_RECTANGULAR50(79),PWM_DUTY_RECTANGULAR50(80),PWM_DUTY_RECTANGULAR50(81),PWM_DUTY_RECTANGULAR50(82),PWM_DUTY_RECTANGULAR50(83),PWM_DUTY_RECTANGULAR50(84),PWM_DUTY_RECTANGULAR50(85),PWM_DUTY_RECTANGULAR50(86),PWM_DUTY_RECTANGULAR50(87),PWM_DUTY_RECTANGULAR50(88),PWM_DUTY_RECTANGULAR50(89),PWM_DUTY_RECTANGULAR50(90),PWM_DUTY_RECTANGULAR50(91),PWM_DUTY_RECTANGULAR50(92),PWM_DUTY_RECTANGULAR50(93),PWM_DUTY_RECTANGULAR50(94),PWM_DUTY_RECTANGULAR50(95),PWM_DUTY_RECTANGULAR50(96),PWM_DUTY_RECTANGULAR50(97),PWM_DUTY_RECTANGULAR50(98),PWM_DUTY_RECTANGULAR50(99),PWM_DUTY_RECTANGULAR50(100),PWM_DUTY_RECTANGULAR50(101),PWM_DUTY_RECTANGULAR50(102),PWM_DUTY_RECTANGULAR50(103),PWM_DUTY_RECTANGULAR50(104),PWM_DUTY_RECTANGULAR50(105),PWM_DUTY_RECTANGULAR50(106),PWM_DUTY_RECTANGULAR50(107),PWM_DUTY_RECTANGULAR50(108),PWM_DUTY_RECTANGULAR50(109),PWM_DUTY_RECTANGULAR50(110),PWM_DUTY_RECTANGULAR50(111),PWM_DUTY_RECTANGULAR50(112),PWM_DUTY_RECTANGULAR50(113),PWM_DUTY_RECTANGULAR50(114),PWM_DUTY_RECTANGULAR50(115),PWM_DUTY_RECTANGULAR50(116),PWM_DUTY_RECTANGULAR50(117),PWM_DUTY_RECTANGULAR50(118),PWM_DUTY_RECTANGULAR50(119),PWM_DUTY_RECTANGULAR50(120),PWM_DUTY_RECTANGULAR50(121),PWM_DUTY_RECTANGULAR50(122),PWM_DUTY_RECTANGULAR50(123),PWM_DUTY_RECTANGULAR50(124),PWM_DUTY_RECTANGULAR50(125),PWM_DUTY_RECTANGULAR50(126),PWM_DUTY_RECTANGULAR50(127),PWM_DUTY_RECTANGULAR50(128),PWM_DUTY_RECTANGULAR50(129),PWM_DUTY_RECTANGULAR50(130),PWM_DUTY_RECTANGULAR50(131),PWM_DUTY_RECTANGULAR50(132),PWM_DUTY_RECTANGULAR50(133),PWM_DUTY_RECTANGULAR50(134),PWM_DUTY_RECTANGULAR50(135),PWM_DUTY_RECTANGULAR50(136),PWM_DUTY_RECTANGULAR50(137),PWM_DUTY_RECTANGULAR50(138),PWM_DUTY_RECTANGULAR50(139),PWM_DUTY_RECTANGULAR50(140),PWM_DUTY_RECTANGULAR50(141),PWM_DUTY_RECTANGULAR50(142),PWM_DUTY_RECTANGULAR50(143),PWM_DUTY_RECTANGULAR50(144),PWM_DUTY_RECTANGULAR50(145),PWM_DUTY_RECTANGULAR50(146),PWM_DUTY_RECTANGULAR50(147),PWM_DUTY_RECTANGULAR50(148),PWM_DUTY_RECTANGULAR50(149),PWM_DUTY_RECTANGULAR50(150),PWM_DUTY_RECTANGULAR50(151),PWM_DUTY_RECTANGULAR50(152),PWM_DUTY_RECTANGULAR50(153),PWM_DUTY_RECTANGULAR50(154),PWM_DUTY_RECTANGULAR50(155),PWM_DUTY_RECTANGULAR50(156),PWM_DUTY_RECTANGULAR50(157),PWM_DUTY_RECTANGULAR50(158),PWM_DUTY_RECTANGULAR50(159),PWM_DUTY_RECTANGULAR50(160),PWM_DUTY_RECTANGULAR50(161),PWM_DUTY_RECTANGULAR50(162),PWM_DUTY_RECTANGULAR50(163),PWM_DUTY_RECTANGULAR50(164),PWM_DUTY_RECTANGULAR50(165),PWM_DUTY_RECTANGULAR50(166),PWM_DUTY_RECTANGULAR50(167),PWM_DUTY_RECTANGULAR50(168),PWM_DUTY_RECTANGULAR50(169),PWM_DUTY_RECTANGULAR50(170),PWM_DUTY_RECTANGULAR50(171),PWM_DUTY_RECTANGULAR50(172),PWM_DUTY_RECTANGULAR50(173),PWM_DUTY_RECTANGULAR50(174),PWM_DUTY_RECTANGULAR50(175),PWM_DUTY_RECTANGULAR50(176),PWM_DUTY_RECTANGULAR50(177),PWM_DUTY_RECTANGULAR50(178),PWM_DUTY_RECTANGULAR50(179),PWM_DUTY_RECTANGULAR50(180),PWM_DUTY_RECTANGULAR50(181),PWM_DUTY_RECTANGULAR50(182),PWM_DUTY_RECTANGULAR50(183),PWM_DUTY_RECTANGULAR50(184),PWM_DUTY_RECTANGULAR50(185),PWM_DUTY_RECTANGULAR50(186),PWM_DUTY_RECTANGULAR50(187),PWM_DUTY_RECTANGULAR50(188),PWM_DUTY_RECTANGULAR50(189),PWM_DUTY_RECTANGULAR50(190),PWM_DUTY_RECTANGULAR50(191),PWM_DUTY_RECTANGULAR50(192),PWM_DUTY_RECTANGULAR50(193),PWM_DUTY_RECTANGULAR50(194),PWM_DUTY_RECTANGULAR50(195),PWM_DUTY_RECTANGULAR50(196),PWM_DUTY_RECTANGULAR50(197),PWM_DUTY_RECTANGULAR50(198),PWM_DUTY_RECTANGULAR50(199),PWM_DUTY_RECTANGULAR50(200),PWM_DUTY_RECTANGULAR50(201),PWM_DUTY_RECTANGULAR50(202),PWM_DUTY_RECTANGULAR50(203),PWM_DUTY_RECTANGULAR50(204),PWM_DUTY_RECTANGULAR50(205),PWM_DUTY_RECTANGULAR50(206),PWM_DUTY_RECTANGULAR50(207),PWM_DUTY_RECTANGULAR50(208),PWM_DUTY_RECTANGULAR50(209),PWM_DUTY_RECTANGULAR50(210),PWM_DUTY_RECTANGULAR50(211),PWM_DUTY_RECTANGULAR50(212),PWM_DUTY_RECTANGULAR50(213),PWM_DUTY_RECTANGULAR50(214),PWM_DUTY_RECTANGULAR50(215),PWM_DUTY_RECTANGULAR50(216),PWM_DUTY_RECTANGULAR50(217),PWM_DUTY_RECTANGULAR50(218),PWM_DUTY_RECTANGULAR50(219),PWM_DUTY_RECTANGULAR50(220),PWM_DUTY_RECTANGULAR50(221),PWM_DUTY_RECTANGULAR50(222),PWM_DUTY_RECTANGULAR50(223),PWM_DUTY_RECTANGULAR50(224),PWM_DUTY_RECTANGULAR50(225),PWM_DUTY_RECTANGULAR50(226),PWM_DUTY_RECTANGULAR50(227),PWM_DUTY_RECTANGULAR50(228),PWM_DUTY_RECTANGULAR50(229),PWM_DUTY_RECTANGULAR50(230),PWM_DUTY_RECTANGULAR50(231),PWM_DUTY_RECTANGULAR50(232),PWM_DUTY_RECTANGULAR50(233),PWM_DUTY_RECTANGULAR50(234),PWM_DUTY_RECTANGULAR50(235),PWM_DUTY_RECTANGULAR50(236),PWM_DUTY_RECTANGULAR50(237),PWM_DUTY_RECTANGULAR50(238),PWM_DUTY_RECTANGULAR50(239),PWM_DUTY_RECTANGULAR50(240),PWM_DUTY_RECTANGULAR50(241),PWM_DUTY_RECTANGULAR50(242),PWM_DUTY_RECTANGULAR50(243),PWM_DUTY_RECTANGULAR50(244),PWM_DUTY_RECTANGULAR50(245),PWM_DUTY_RECTANGULAR50(246),PWM_DUTY_RECTANGULAR50(247),PWM_DUTY_RECTANGULAR50(248),PWM_DUTY_RECTANGULAR50(249),PWM_DUTY_RECTANGULAR50(250),PWM_DUTY_RECTANGULAR50(251),PWM_DUTY_RECTANGULAR50(252),PWM_DUTY_RECTANGULAR50(253),PWM_DUTY_RECTANGULAR50(254),PWM_DUTY_RECTANGULAR50(255)};
volatile constexpr PROGMEM const uint8_t expReleaseDuty[]={EXP_RELEASE(0),EXP_RELEASE(1),EXP_RELEASE(2),EXP_RELEASE(3),EXP_RELEASE(4),EXP_RELEASE(5),EXP_RELEASE(6),EXP_RELEASE(7),EXP_RELEASE(8),EXP_RELEASE(9),EXP_RELEASE(10),EXP_RELEASE(11),EXP_RELEASE(12),EXP_RELEASE(13),EXP_RELEASE(14),EXP_RELEASE(15),EXP_RELEASE(16),EXP_RELEASE(17),EXP_RELEASE(18),EXP_RELEASE(19),EXP_RELEASE(20),EXP_RELEASE(21),EXP_RELEASE(22),EXP_RELEASE(23),EXP_RELEASE(24),EXP_RELEASE(25),EXP_RELEASE(26),EXP_RELEASE(27),EXP_RELEASE(28),EXP_RELEASE(29),EXP_RELEASE(30),EXP_RELEASE(31),EXP_RELEASE(32),EXP_RELEASE(33),EXP_RELEASE(34),EXP_RELEASE(35),EXP_RELEASE(36),EXP_RELEASE(37),EXP_RELEASE(38),EXP_RELEASE(39),EXP_RELEASE(40),EXP_RELEASE(41),EXP_RELEASE(42),EXP_RELEASE(43),EXP_RELEASE(44),EXP_RELEASE(45),EXP_RELEASE(46),EXP_RELEASE(47),EXP_RELEASE(48),EXP_RELEASE(49),EXP_RELEASE(50),EXP_RELEASE(51),EXP_RELEASE(52),EXP_RELEASE(53),EXP_RELEASE(54),EXP_RELEASE(55),EXP_RELEASE(56),EXP_RELEASE(57),EXP_RELEASE(58),EXP_RELEASE(59),EXP_RELEASE(60),EXP_RELEASE(61),EXP_RELEASE(62),0};
volatile constexpr PROGMEM const uint8_t cosReleaseDuty[]={COS_RELEASE(0),COS_RELEASE(1),COS_RELEASE(2),COS_RELEASE(3),COS_RELEASE(4),COS_RELEASE(5),COS_RELEASE(6),COS_RELEASE(7),COS_RELEASE(8),COS_RELEASE(9),COS_RELEASE(10),COS_RELEASE(11),COS_RELEASE(12),COS_RELEASE(13),COS_RELEASE(14),COS_RELEASE(15),COS_RELEASE(16),COS_RELEASE(17),COS_RELEASE(18),COS_RELEASE(19),COS_RELEASE(20),COS_RELEASE(21),COS_RELEASE(22),COS_RELEASE(23),COS_RELEASE(24),COS_RELEASE(25),COS_RELEASE(26),COS_RELEASE(27),COS_RELEASE(28),COS_RELEASE(29),COS_RELEASE(30),COS_RELEASE(31),COS_RELEASE(32),COS_RELEASE(33),COS_RELEASE(34),COS_RELEASE(35),COS_RELEASE(36),COS_RELEASE(37),COS_RELEASE(38),COS_RELEASE(39),COS_RELEASE(40),COS_RELEASE(41),COS_RELEASE(42),COS_RELEASE(43),COS_RELEASE(44),COS_RELEASE(45),COS_RELEASE(46),COS_RELEASE(47),COS_RELEASE(48),COS_RELEASE(49),COS_RELEASE(50),COS_RELEASE(51),COS_RELEASE(52),COS_RELEASE(53),COS_RELEASE(54),COS_RELEASE(55),COS_RELEASE(56),COS_RELEASE(57),COS_RELEASE(58),COS_RELEASE(59),COS_RELEASE(60),COS_RELEASE(61),COS_RELEASE(62),0};
//基準時間変数
uint8_t refMs;
//演奏楽曲定義ヘッダインクルード
#include "test.h"
//各チャンネルフラッシュアドレスインデックスオフセット
constexpr uint16_t* beepFreqChAddressOffset[7] = {beepFreqCh0,beepFreqCh1,beepFreqCh2,beepFreqCh3,beepFreqCh4,beepFreqCh5,noiseFreq};
constexpr uint16_t* beepDurationChAddressOffset[7] = {beepDurationCh0,beepDurationCh1,beepDurationCh2,beepDurationCh3,beepDurationCh4,beepDurationCh5,noiseDuration};
constexpr uint8_t SW_AssignDATA[7]={0b00000100,0b00001000,0b00010000,0b00100000,0b00001000,0b00010000,0b00100000};
constexpr uint8_t* SW_AssignPORT[7]={&PINC,&PINC,&PINC,&PINC,&PINB,&PINB,&PINB};
constexpr uint8_t LED_AssignDATA[7]={0b00000100,0b00000010,0b00010000,0b00001000,0b00000100,0b00000001,0b10000000};
constexpr uint8_t* LED_AssignPORT[7]={&PORTB,&PORTB,&PORTD,&PORTD,&PORTD,&PORTB,&PORTD};
void setup() {  //レジスタ初期化
  DDRD = 0b11111100; //入出力レジスタ初期化
  DDRC = 0b00000000;
  DDRB = 0b00000111;
  //ノイズ生成に乱数が必要のためADC使用
  ADMUX = 0b11000000; //PC0ポート(Arduino A0ピン)使用、ADC結果右揃え、内部1.1V基準電圧
  ADCSRA = 0b10000111;  //ADC有効　前置分周128
  ADCSRB = 0b00000000;  //ADC 連続変換動作
  //Timer0 initialize
  TCCR0A = 0b00000011;  //8bit位相基準PWM反転出力
  TCCR0B = 0b00000001;  //分周なし
  OCR0A = 255;
  OCR0B = 255;
  //Timer1 initialize
  TCCR1A = 0; // 初期化
  TCCR1B = 0b00001001; //前置分周なし CTCモード
  OCR1A = 749;         //Timer1 COMPA 32768Hz CTCカウンタ749上限に設定24.576MHz 
  //Timer2 initialize.
  TCCR2A = 0b00000010; // CTCモードに設定
  TCCR2B = 0b00000101; // 前置分周比128
  OCR2A = 191;        // Timer2 COMPA 1kHz 1msec CTCカウンタ191上限に設定24.576MHz
}
int16_t main (){
  setup ();
  sei();
  // do other stuff here  
  while(true){
    loop();
  };
}
void loop() { //メインルーチン
  static bool isBottonPushed = false;
  if(TIMSK2==0b00000000){
    if((PINC&0b00000010)==0b00000010&&!isBottonPushed){
      isBottonPushed = true;
      //wave channel init.
      struct envelope *cEnv_ptr = &cEnv(0);
      struct LFO *LFO_ptr = &LFO[0];
      struct conductor *CON_ptr = &CON[0];
      for(uint8_t c=0;c<=6;c++,cEnv_ptr++,LFO_ptr++,CON_ptr++){
        CON_ptr->returnAddress=0;
        CON_ptr->beepMs=0;
        CON_ptr->address=0;
        cEnv_ptr->nextWaitTimeMs=0;
        cEnv_ptr->attackCount=0;
        cEnv_ptr->decayCount=0;
        cEnv_ptr->sustainReleaseCount=0;
        LFO_ptr->mode=false;
        //初期パラメータセット
        CON_ptr->freq = pgm_read_word(beepFreqChAddressOffset[c])<<1;
        CON_ptr->beepDuration = pgm_read_word(beepDurationChAddressOffset[c]);
        if(c<=5){
          beepParmInit(c);
          uint32_t tmp;
          u16u16Mul(tmp, CON_ptr->freq, wDDS[c].detunePitchDivide32768);
          wDDS[c].carrierDetuneFreq=tmp>>15;
          u16u16Mul(tmp, CON_ptr->freq, wDDS[c].modularFreqRatioDivide256);
          wDDS[c].modularFreq=tmp>>8;
        }else{
          noiseParmInit();
        }
        if(CON_ptr->freq!=0){
          if(cEnv_ptr->attackDuration!=0){
            cEnv_ptr->status=ATTACK;
          }else if(cEnv_ptr->decayDuration!=0){
            cEnv_ptr->status=DECAY;
          }else if(cEnv_ptr->sustainDuration!=0){
            cEnv_ptr->status=SUSTAIN;
          }else if(cEnv_ptr->releaseDuration!=0){
            cEnv_ptr->status=RELEASE;
          }else{
            cEnv_ptr->status=CONSTANT;
          }
          if(cEnv_ptr->status==ATTACK){
            if(cEnv_ptr->isAllowOverrideAttackDuty){
              cEnv_ptr->calculatedDuty=0;
            }
          }else{
            cEnv_ptr->calculatedDuty=255;
          }
        }else{
          cEnv_ptr->status = MUTE;
        }
      }
      struct envelope *mEnv_ptr = &mEnv(0);
      for(uint8_t c=0;c<=5;c++,mEnv_ptr++){
        mEnv_ptr->nextWaitTimeMs=0;
        mEnv_ptr->attackCount=0;
        mEnv_ptr->decayCount=0;
        mEnv_ptr->sustainReleaseCount=0;
        if(wDDS[c].modularFreq!=0){
          if(mEnv_ptr->attackDuration!=0){
            mEnv_ptr->status=ATTACK;
          }else if(mEnv_ptr->decayDuration!=0){
            mEnv_ptr->status=DECAY;
          }else if(mEnv_ptr->sustainDuration!=0){
            mEnv_ptr->status=SUSTAIN;
          }else if(mEnv_ptr->releaseDuration!=0){
            mEnv_ptr->status=RELEASE;
          }else{
            mEnv_ptr->status=CONSTANT;
          }
          if(mEnv_ptr->status==ATTACK){
            if(mEnv_ptr->isAllowOverrideAttackDuty){
              mEnv_ptr->calculatedDuty=0;
            }
          }else{
            mEnv_ptr->calculatedDuty=255;
          }
        }else{
          mEnv_ptr->status = MUTE;
        }
        if(wDDS[c].isOnlyDetuneDuringSR){
          wDDS[c].outputVolumeDetune = 0;
        }else{
          wDDS[c].outputVolumeDetune = wDDS[c].volumeDetune;
        }
      }

      OCR0A=255;
      OCR0B=255;
      TIMSK1 |= 0b00000010;  //Timer1 COMPA割込み有効
      TIMSK2 |= 0b00000010;  //Timer2 COMPA割込み有効
      TCCR0A |= 0b11110000;  //PWM反転出力許可
    }
    if((PINC&0b00000010)==0b00000000&&isBottonPushed){
      isBottonPushed = false;
    }
  }else{
    //楽曲データ進行、エンベロープ処理
    struct envelope *cEnv_ptr = &cEnv(0);
    struct envelope *mEnv_ptr = &mEnv(0);
    struct conductor *CON_ptr = &CON[0];
    for(uint8_t c = 0;c<=5;c++,cEnv_ptr++,mEnv_ptr++,CON_ptr++){
      if(CON_ptr->beepMs>=CON_ptr->beepDuration){
        CON_ptr->beepMs-=CON[c].beepDuration;
        uint16_t beepFreq;
        beepFreq = nextBeepNote(c);
        //コマンド処理
        while(beepFreq>=65000){
          commandExecute(c,beepFreq);
          beepFreq = nextBeepNote(c);
        }
        //チャンネル初期化
        if(beepFreq!=0){
          CON_ptr->freq = beepFreq<<1;//フラッシュから楽曲データをコピー、値を2倍にして渡すことで高速処理部でレジスタ移動による0クロックで256除算を行う
          uint32_t tmp;
          u16u16Mul(tmp, CON_ptr->freq, wDDS[c].detunePitchDivide32768);
          wDDS[c].carrierDetuneFreq=tmp>>15;
          if(LFO[c].changeValue==0||LFO[c].isConvergence||LFO[c].isInitializeModulationIndex){
              wDDS[c].modularIndexDivide256=wDDS[c].tempModularIndexDivide256;
          }
          if(LFO[c].isConvergence||LFO[c].isInitializeModulationIndex){
            LFO[c].mode=false;
          }
          u16u16Mul(tmp, CON_ptr->freq, wDDS[c].modularFreqRatioDivide256);
          wDDS[c].modularFreq=tmp>>8;
          wDDS[c].outputVolumeDetune = wDDS[c].volumeDetune;
          //エンベロープ初期化
          cEnv_ptr->nextWaitTimeMs=0;
          cEnv_ptr->attackCount=0;
          cEnv_ptr->decayCount=0;
          cEnv_ptr->sustainReleaseCount=0;
          if(wDDS[c].isOnlyDetuneDuringSR){
            wDDS[c].outputVolumeDetune = 0;
          }else{
            wDDS[c].outputVolumeDetune = wDDS[c].volumeDetune;
          }
          if(cEnv_ptr->attackDuration!=0){
            cEnv_ptr->status=ATTACK;
          }else if(cEnv_ptr->decayDuration!=0){
            cEnv_ptr->status=DECAY;
          }else if(cEnv_ptr->sustainDuration!=0){
            cEnv_ptr->status=SUSTAIN;
          }else{
            cEnv_ptr->status=CONSTANT;
          }
          if(cEnv_ptr->status==ATTACK){
            if(cEnv_ptr->isAllowOverrideAttackDuty){
              cEnv_ptr->calculatedDuty=0;
            }
          }else{
            cEnv_ptr->calculatedDuty=255;
          }
        }else if(cEnv_ptr->releaseDuration==0){
          cEnv_ptr->status=MUTE;
        }else{
          if(cEnv_ptr->isEnableRelease){
            cEnv_ptr->status=RELEASE;
          }else{
            cEnv_ptr->status=MUTE;
          }
        }
        
        if(beepFreq!=0){
          //エンベロープ初期化
          mEnv_ptr->nextWaitTimeMs=0;
          mEnv_ptr->attackCount=0;
          mEnv_ptr->decayCount=0;
          mEnv_ptr->sustainReleaseCount=0;
          if(mEnv_ptr->attackDuration!=0){
            mEnv_ptr->status=ATTACK;
          }else if(mEnv_ptr->decayDuration!=0){
            mEnv_ptr->status=DECAY;
          }else if(mEnv_ptr->sustainDuration!=0){
            mEnv_ptr->status=SUSTAIN;
          }else{
            mEnv_ptr->status=CONSTANT;
          }
          if(mEnv_ptr->status==ATTACK){
            if(mEnv_ptr->isAllowOverrideAttackDuty){
              mEnv_ptr->calculatedDuty=0;
            }
          }else{
            mEnv_ptr->calculatedDuty=255;
          }
        }else if(mEnv_ptr->releaseDuration==0){
          mEnv_ptr->status=CONSTANT;
        }else{
          if(mEnv_ptr->isEnableRelease){
            mEnv_ptr->status=RELEASE;
          }else{
            mEnv_ptr->status=MUTE;
          }
        }
      }
    }
    //noise
    if(CON[6].beepMs>=CON[6].beepDuration){
      CON[6].beepMs-=CON[6].beepDuration;
      uint16_t getNoiseFreq;
      getNoiseFreq = nextNoiseNote();
      //コマンド処理
      while(getNoiseFreq>=65000){
        commandExecute(6,getNoiseFreq);
        getNoiseFreq = nextNoiseNote();
      }
      if(getNoiseFreq!=0){
        //エンベロープ初期化
        cEnv(6).nextWaitTimeMs=0;
        cEnv(6).attackCount=0;
        cEnv(6).decayCount=0;
        cEnv(6).sustainReleaseCount=0;
        CON[6].freq = getNoiseFreq<<1;//フラッシュから楽曲データをコピー、値を2倍にして渡すことで高速処理部でレジスタ移動による0クロックで256除算を行う
        if(cEnv(6).attackDuration!=0){
          cEnv(6).status=ATTACK;
        }else if(cEnv(6).decayDuration!=0){
          cEnv(6).status=DECAY;
        }else if(cEnv(6).sustainDuration!=0){
          cEnv(6).status=SUSTAIN;
        }else if(cEnv(6).releaseDuration!=0){
          cEnv(6).status=RELEASE;
        }else{
          cEnv(6).status=CONSTANT;
        }
        if(cEnv(6).status==ATTACK){
          if(cEnv(6).isAllowOverrideAttackDuty){
            cEnv(6).calculatedDuty=0;
          }
        }else{
          cEnv(6).calculatedDuty=255;
        }
      }else if(cEnv(6).releaseDuration==0){
        cEnv(6).status=MUTE;
      }else{
        if(cEnv(6).isEnableRelease){
          cEnv(6).status=RELEASE;
        }else{
          cEnv(6).status=MUTE;
        }
      }
    }
    struct envelope *env_ptr = &env[0];
    for(uint8_t c=0;c<=12;c++,env_ptr++){
      //Envelope
      if(env_ptr->status==ATTACK){
        if(env_ptr->nextWaitTimeMs>=env_ptr->attackDuration){
          env_ptr->nextWaitTimeMs-=env_ptr->attackDuration;
          uint8_t newEnvelopeDuty = (uint8_t)((int16_t)pgm_read_byte(sinSampling+191-env_ptr->attackCount)+128);
          env_ptr->calculatedDuty=(env_ptr->calculatedDuty>newEnvelopeDuty)? env_ptr->calculatedDuty : newEnvelopeDuty;
          if(env_ptr->attackCount+env_ptr->attackChangeValue<128){
            env_ptr->attackCount+=env_ptr->attackChangeValue;
          }else{
            if(env_ptr->decayDuration!=0){
              env_ptr->status=DECAY;
            }else if(env_ptr->sustainDuration!=0){
              env_ptr->status=SUSTAIN;
            }else{
              env_ptr->status=CONSTANT;
            }
          }
        }
      }else if(env_ptr->status==DECAY){
        if(env_ptr->nextWaitTimeMs>=env_ptr->decayDuration){
          env_ptr->nextWaitTimeMs-=env_ptr->decayDuration;
          uint8_t newEnvelopeDuty = (uint8_t)((int16_t)pgm_read_byte(sinSampling+63-env_ptr->decayCount)+128);
          env_ptr->calculatedDuty=(env_ptr->calculatedDuty>newEnvelopeDuty)? newEnvelopeDuty : env_ptr->calculatedDuty;
          if(env_ptr->decayCount+env_ptr->decayChangeValue<64){
            env_ptr->decayCount+=env_ptr->decayChangeValue;
          }else{
            if(env_ptr->sustainDuration!=0){
              env_ptr->status=SUSTAIN;
            }else{
              env_ptr->status=CONSTANT;
            }
          }
        }
      }else if(env_ptr->status==SUSTAIN){
        if(env_ptr->nextWaitTimeMs>=env_ptr->sustainDuration&&env_ptr->calculatedDuty>env_ptr->sustainLowerValue){
          env_ptr->nextWaitTimeMs-=env_ptr->sustainDuration;
          switch(env_ptr->sustainMode){
            case 0:
              env_ptr->calculatedDuty=(252-(env_ptr->sustainReleaseCount<<2))>>(env_ptr->decayDuration!=0x00);
              break;
            case 1:
              env_ptr->calculatedDuty = pgm_read_byte(expReleaseDuty+env_ptr->sustainReleaseCount)>>(env_ptr->decayDuration!=0x00);
              break;
            case 2:
              env_ptr->calculatedDuty = pgm_read_byte(cosReleaseDuty+env_ptr->sustainReleaseCount)>>(env_ptr->decayDuration!=0x00);
              break;
          }
          if(env_ptr->sustainReleaseCount+env_ptr->sustainChangeValue<64){
            env_ptr->sustainReleaseCount+=env_ptr->sustainChangeValue;
          }else{
            env_ptr->status=CONSTANT;
          }
        }
      }else if(env_ptr->status==RELEASE){
        if(env_ptr->nextWaitTimeMs>=env_ptr->releaseDuration&&env_ptr->calculatedDuty>env_ptr->releaseLowerValue){
          env_ptr->nextWaitTimeMs-=env_ptr->releaseDuration;
          switch(env_ptr->releaseMode){
            case 0:
              env_ptr->calculatedDuty = (252-(env_ptr->sustainReleaseCount<<2))>>(env_ptr->decayDuration!=0x00);
              break;
            case 1:
              env_ptr->calculatedDuty = pgm_read_byte(expReleaseDuty+env_ptr->sustainReleaseCount)>>(env_ptr->decayDuration!=0x00);
              break;
            case 2:
              env_ptr->calculatedDuty = pgm_read_byte(cosReleaseDuty+env_ptr->sustainReleaseCount)>>(env_ptr->decayDuration!=0x00);
              break;
          }
          if(env_ptr->sustainReleaseCount+env_ptr->releaseChangeValue<64){
            env_ptr->sustainReleaseCount+=env_ptr->releaseChangeValue;
          }else{
            env_ptr->status=CONSTANT;
          }
        }
      }else if(env_ptr->status==MUTE){
        env_ptr->calculatedDuty = 0;
      }
    }
    CON_ptr = &CON[0];
    struct pitchBend *pb_ptr = &pb[0];
    for(uint8_t c=0;c<=6;c++,pb_ptr++,CON_ptr++){
      //pitch bend
      if(pb_ptr->nextWaitTimeMs>=pb_ptr->interval){
        pb_ptr->nextWaitTimeMs=0;
        uint32_t tmp;
        u16u16Mul(tmp, CON_ptr->freq, pb_ptr->ratioDivide32768);
        if(pb_ptr->ratioDivide32768>32768){
          if((tmp>>16)<pb_ptr->higherFreq){
            CON_ptr->freq=tmp>>15;
          }else{
            CON_ptr->freq=pb_ptr->higherFreq<<1;
          }
        }else if(pb_ptr->ratioDivide32768<32768){
          if((tmp>>16)>pb_ptr->lowerFreq){
            CON_ptr->freq=tmp>>15;
          }else{
            CON_ptr->freq=pb_ptr->lowerFreq<<1;
          }
        }
        if(c<=5){
          u16u16Mul(tmp, CON_ptr->freq, wDDS[c].modularFreqRatioDivide256);
          wDDS[c].modularFreq=tmp>>8;
        }
      }
    }
    struct LFO *LFO_ptr = &LFO[0];
    for(uint8_t c=0;c<=5;c++,LFO_ptr++){
      //Low Frequency Oscillator
      if((LFO_ptr->nextWaitTimeMs>LFO_ptr->duration)&&cEnv(c).calculatedDuty!=0){
        LFO_ptr->nextWaitTimeMs-=LFO_ptr->duration;
        if(!LFO_ptr->mode||!LFO_ptr->isConvergence){
          if(LFO_ptr->mode){
            if(((uint16_t)(wDDS[c].modularIndexDivide256+LFO_ptr->changeValue))>=(uint16_t)wDDS[c].tempModularIndexDivide256){
              wDDS[c].modularIndexDivide256=wDDS[c].tempModularIndexDivide256;
              LFO_ptr->mode=false;
            }else{
              wDDS[c].modularIndexDivide256=wDDS[c].modularIndexDivide256+LFO_ptr->changeValue;
            }
          }else{
            if((uint16_t)wDDS[c].modularIndexDivide256>(uint16_t)(LFO_ptr->changeValue+LFO_ptr->lowerValue)){
              wDDS[c].modularIndexDivide256=wDDS[c].modularIndexDivide256-LFO_ptr->changeValue;
            }else{
              wDDS[c].modularIndexDivide256=LFO_ptr->lowerValue;
              LFO_ptr->mode=true;
            }
          }
        }
      }
      //calc outputModularEnvelopeDuty.
      mEnv(c).outputDuty = ((uint16_t)mEnv(c).calculatedDuty*(uint16_t)wDDS[c].modularIndexDivide256)>>8;
    }
    //基準時間加算、チャンネル出力許可、ボリューム乗算処理。LED点灯
    if(refMs>0){
      TIMSK2 &= 0b11111101;  //Timer2 COMPA割込み禁止
      byte getMs = refMs;
      refMs=0;
      TIMSK2 |= 0b00000010;  //Timer2 COMPA割込み有効
      envelope *env_ptr = &env[0];
      for(uint8_t c=0;c<=12;c++,env_ptr++){
        env_ptr->nextWaitTimeMs+=getMs;
      }
      for(uint8_t c=0;c<=5;c++){
        CON[c].beepMs+=getMs;
        LFO[c].nextWaitTimeMs+=getMs;
        pb[c].nextWaitTimeMs+=getMs;
        if(cEnv(c).sustainReleaseCount!=0){
          wDDS[c].outputVolumeDetune = wDDS[c].outputVolumeDetune<wDDS[c].volumeDetune?wDDS[c].outputVolumeDetune+1:wDDS[c].volumeDetune;
        }

        if((*SW_AssignPORT[c]&SW_AssignDATA[c])==0b00000000){
          if(cEnv(c).calculatedDuty!=0){
            *LED_AssignPORT[c] |= LED_AssignDATA[c];
          }else{
            wDDS[c].carrierOperator=0;
            wDDS[c].carrierDetuneOperator=0;
            wDDS[c].modularOperator=0;
            *LED_AssignPORT[c] &= ~LED_AssignDATA[c];
          }
          cEnv(c).outputDuty=((uint16_t)cEnv(c).calculatedDuty*(uint16_t)wDDS[c].volume)>>8;
          wDDS[c].outputCarrierDetuneDuty=((uint16_t)cEnv(c).calculatedDuty*(uint16_t)wDDS[c].outputVolumeDetune)>>8;
        }else{
          *LED_AssignPORT[c] &= ~LED_AssignDATA[c];
          cEnv(c).outputDuty=0;
          wDDS[c].outputCarrierDetuneDuty=0;
        }
      }
      CON[6].beepMs+=getMs;
      pb[6].nextWaitTimeMs+=getMs;
      if((*SW_AssignPORT[6]&SW_AssignDATA[6])==0b00000000){
        if(cEnv(6).calculatedDuty!=0){
          *LED_AssignPORT[6] |= LED_AssignDATA[6];
        }else{
          *LED_AssignPORT[6] &= ~LED_AssignDATA[6];
        }
        cEnv(6).outputDuty=((uint16_t)cEnv(6).calculatedDuty*(uint16_t)nDDS.volume)>>8;
      }else{
        *LED_AssignPORT[6] &= ~LED_AssignDATA[6];
        cEnv(6).outputDuty=0;
      }
      //ピン入力検知
      if((PINC&0b00000010)==0b00000010&&!isBottonPushed){
        isBottonPushed = true;
        TIMSK1 &= 0b11111101;  //Timer1 COMPA割込み禁止
        TIMSK2 &= 0b11111101;  //Timer2 COMPA割込み禁止
        TCCR0A &= 0b00001111;  //PWM反転出力禁止
        PORTD &= 0b00000011;
        PORTB &= 0b11111000;
      }
      if((PINC&0b00000010)==0b00000000&&isBottonPushed){
        isBottonPushed = false;
      }
    }
  }
}
void commandExecute(uint8_t c,uint16_t beepFreq){
  switch(beepFreq){
    case cSpT:
      switch(CON[c].beepDuration){
        case SIN:
          wDDS[c].carrierSamplingTable = sinSampling;
          break;
        case SAW:
          wDDS[c].carrierSamplingTable = sawSampling;
          break;
        case TRI:
          wDDS[c].carrierSamplingTable = triangularSampling;
          break;
        case RT12:
          wDDS[c].carrierSamplingTable = rectangularSampling12_5;
          break;
        case RT25:
          wDDS[c].carrierSamplingTable = rectangularSampling25;
          break;
        case RT50:
          wDDS[c].carrierSamplingTable = rectangularSampling50;
          break;
      }
      break;
    case dSpT:
      switch(CON[c].beepDuration){
        case SIN:
          wDDS[c].carrierDetuneSamplingTable = sinSampling;
          break;
        case SAW:
          wDDS[c].carrierDetuneSamplingTable = sawSampling;
          break;
        case TRI:
          wDDS[c].carrierDetuneSamplingTable = triangularSampling;
          break;
        case RT12:
          wDDS[c].carrierDetuneSamplingTable = rectangularSampling12_5;
          break;
        case RT25:
          wDDS[c].carrierDetuneSamplingTable = rectangularSampling25;
          break;
        case RT50:
          wDDS[c].carrierDetuneSamplingTable = rectangularSampling50;
          break;
      }
      break;
    case mSpT:
      switch(CON[c].beepDuration){
        case SIN:
          wDDS[c].modularSamplingTable = sinSampling;
          break;
        case SAW:
          wDDS[c].modularSamplingTable = sawSampling;
          break;
        case TRI:
          wDDS[c].modularSamplingTable = triangularSampling;
          break;
        case RT12:
          wDDS[c].modularSamplingTable = rectangularSampling12_5;
          break;
        case RT25:
          wDDS[c].modularSamplingTable = rectangularSampling25;
          break;
        case RT50:
          wDDS[c].modularSamplingTable = rectangularSampling50;
          break;
      }
      break;
    case CVol:
      if(c==6){
        nDDS.volume = CON[c].beepDuration;
      }else{
        wDDS[c].volume = CON[c].beepDuration;
      }
      break;
    case DVol:
      wDDS[c].volumeDetune = CON[c].beepDuration;
      break;
    case RetA:
      CON[c].returnAddress = CON[c].beepDuration;
      break;
    case cEvA:
      cEnv(c).attackDuration = CON[c].beepDuration;
      break;
    case cEvD:
      cEnv(c).decayDuration = CON[c].beepDuration;
      break;
    case cEvS:
      cEnv(c).sustainDuration = CON[c].beepDuration;
      break;
    case cEvR:
      cEnv(c).releaseDuration = CON[c].beepDuration;
      break;
    case cEAD:
      cEnv(c).attackChangeValue = CON[c].beepDuration;
      break;
    case cEDD:
      cEnv(c).decayChangeValue = CON[c].beepDuration;
      break;
    case cESD:
      cEnv(c).sustainChangeValue = CON[c].beepDuration;
      break;
    case cERD:
      cEnv(c).releaseChangeValue = CON[c].beepDuration;
      break;
    case cOAk:
      cEnv(c).isAllowOverrideAttackDuty = CON[c].beepDuration;
      break;
    case cESM:
      cEnv(c).sustainMode = CON[c].beepDuration;
      break;
    case cERM:
      cEnv(c).releaseMode = CON[c].beepDuration;
      break;
    case cInR:
      cEnv(c).isEnableRelease = CON[c].beepDuration;
      break;
    case cESL:
      cEnv(c).sustainLowerValue = CON[c].beepDuration;
      break;
    case cERL:
      cEnv(c).releaseLowerValue = CON[c].beepDuration;
      break;
    case mEvA:
      mEnv(c).attackDuration = CON[c].beepDuration;
      break;
    case mEvD:
      mEnv(c).decayDuration = CON[c].beepDuration;
      break;
    case mEvS:
      mEnv(c).sustainDuration = CON[c].beepDuration;
      break;
    case mEvR:
      mEnv(c).releaseDuration = CON[c].beepDuration;
      break;
    case mEAD:
      mEnv(c).attackChangeValue = CON[c].beepDuration;
      break;
    case mEDD:
      mEnv(c).decayChangeValue = CON[c].beepDuration;
      break;
    case mESD:
      mEnv(c).sustainChangeValue = CON[c].beepDuration;
      break;
    case mERD:
      mEnv(c).releaseChangeValue = CON[c].beepDuration;
      break;
    case mOAk:
      mEnv(c).isAllowOverrideAttackDuty = CON[c].beepDuration;
      break;
    case mESM:
      mEnv(c).sustainMode = CON[c].beepDuration;
      break;
    case mERM:
      mEnv(c).releaseMode = CON[c].beepDuration;
      break;
    case mInR:
      mEnv(c).isEnableRelease = CON[c].beepDuration;
      break;
    case mESL:
      mEnv(c).sustainLowerValue = CON[c].beepDuration;
      break;
    case mERL:
      mEnv(c).releaseLowerValue = CON[c].beepDuration;
      break;
    case MdFG:
      wDDS[c].modularFeedbackGainDivide256 = CON[c].beepDuration;
      break;
    case MdIn:
      wDDS[c].tempModularIndexDivide256 = CON[c].beepDuration;
      LFO[c].lowerValue = wDDS[c].tempModularIndexDivide256>LFO[c].lowerValue ? LFO[c].lowerValue : wDDS[c].tempModularIndexDivide256;
      break;
    case MdFR:
      wDDS[c].modularFreqRatioDivide256 = CON[c].beepDuration;
      break;
    case ODSR:
      wDDS[c].isOnlyDetuneDuringSR = CON[c].beepDuration;
      break;
    case DePi:
      wDDS[c].detunePitchDivide32768 = CON[c].beepDuration;
      break;
    case LFDu:
      LFO[c].duration = CON[c].beepDuration;
      break;
    case LFDe:
      LFO[c].changeValue = CON[c].beepDuration;
      break;
    case LFLV:
      LFO[c].lowerValue = wDDS[c].tempModularIndexDivide256>CON[c].beepDuration ? CON[c].beepDuration : wDDS[c].tempModularIndexDivide256;
      break;
    case LFIC:
      LFO[c].isConvergence =  CON[c].beepDuration;
      break;
    case LFIM:
      LFO[c].isInitializeModulationIndex =  CON[c].beepDuration;
      break;
    case PBIn:
      pb[c].interval =  CON[c].beepDuration;
      break;
    case PBRa:
      pb[c].ratioDivide32768 =  CON[c].beepDuration;
      break;
    case PBHF:
      pb[c].higherFreq =  CON[c].beepDuration;
      break;
    case PBLF:
      pb[c].lowerFreq =  CON[c].beepDuration;
      break;
    case NisM:
      nDDS.mode = CON[c].beepDuration;
      break;
  }
}
uint16_t nextBeepNote(uint8_t c){
  CON[c].address++;
  uint16_t beepFreq = pgm_read_word(beepFreqChAddressOffset[c]+CON[c].address);
  if(beepFreq==0xffff){
    CON[c].address=CON[c].returnAddress;
    beepParmInit(c);
    beepFreq = pgm_read_word(beepFreqChAddressOffset[c]+CON[c].address);
  }
  CON[c].beepDuration = pgm_read_word(beepDurationChAddressOffset[c]+CON[c].address);
  return beepFreq;
}
void beepParmInit(uint8_t c){
  //パラメータ初期化
  wDDS[c].carrierSamplingTable=InitCarrierSamplingTable[c];
  wDDS[c].carrierDetuneSamplingTable=InitCarrierDetuneSamplingTable[c];
  wDDS[c].modularSamplingTable=InitModularSamplingTable[c];
  wDDS[c].volume=InitVolumeCh[c];
  wDDS[c].volumeDetune=InitVolumeDetuneCh[c];
  //CON[c].returnAddress=InitLoopAddressCh[c];
  cEnv(c).attackDuration=InitCarrierEnvelopeAttackDuration[c];
  cEnv(c).decayDuration=InitCarrierEnvelopeDecayDuration[c];
  cEnv(c).sustainDuration=InitCarrierEnvelopeSustainDuration[c];
  cEnv(c).releaseDuration=InitCarrierEnvelopeReleaseDuration[c];
  cEnv(c).attackChangeValue=InitCarrierEnvelopeAttackChangeValue[c];
  cEnv(c).decayChangeValue=InitCarrierEnvelopeDecayChangeValue[c];
  cEnv(c).sustainChangeValue=InitCarrierEnvelopeSustainChangeValue[c];
  cEnv(c).releaseChangeValue=InitCarrierEnvelopeReleaseChangeValue[c];
  cEnv(c).sustainLowerValue=InitCarrierEnvelopeSustainLowerValue[c];
  cEnv(c).releaseLowerValue=InitCarrierEnvelopeReleaseLowerValue[c];
  cEnv(c).isAllowOverrideAttackDuty=InitIsAllowOverrideCarrierAttackDuty[c];
  cEnv(c).sustainMode=InitCarrierEnvelopeSustainMode[c];
  cEnv(c).releaseMode=InitCarrierEnvelopeReleaseMode[c];
  cEnv(c).isEnableRelease=InitIsAllowCarrierInterNoteRelease[c];

  mEnv(c).attackDuration=InitModularEnvelopeAttackDuration[c];
  mEnv(c).decayDuration=InitModularEnvelopeDecayDuration[c];
  mEnv(c).sustainDuration=InitModularEnvelopeSustainDuration[c];
  mEnv(c).releaseDuration=InitModularEnvelopeReleaseDuration[c];
  mEnv(c).attackChangeValue=InitModularEnvelopeAttackChangeValue[c];
  mEnv(c).decayChangeValue=InitModularEnvelopeDecayChangeValue[c];
  mEnv(c).sustainChangeValue=InitModularEnvelopeSustainChangeValue[c];
  mEnv(c).releaseChangeValue=InitModularEnvelopeReleaseChangeValue[c];
  mEnv(c).sustainLowerValue=InitModularEnvelopeSustainLowerValue[c];
  mEnv(c).releaseLowerValue=InitModularEnvelopeReleaseLowerValue[c];
  mEnv(c).isAllowOverrideAttackDuty=InitIsAllowOverrideModularAttackDuty[c];
  mEnv(c).sustainMode=InitModularEnvelopeSustainMode[c];
  mEnv(c).releaseMode=InitModularEnvelopeReleaseMode[c];
  mEnv(c).isEnableRelease=InitIsAllowModularInterNoteRelease[c];

  wDDS[c].isOnlyDetuneDuringSR=InitIsOnlyDetuneDuringSR[c];
  wDDS[c].detunePitchDivide32768=InitDetunePitchDivide32768[c];
  wDDS[c].modularFeedbackGainDivide256=InitModulationFeedbackGainDivide256[c];
  wDDS[c].tempModularIndexDivide256=InitModulationIndexDivide256[c];
  wDDS[c].modularFreqRatioDivide256=InitModulationFreqRatioDivide256[c];
  LFO[c].duration=InitModulationLFODuration[c];
  LFO[c].changeValue=InitModulationLFOChangeValue[c];
  LFO[c].lowerValue = InitModulationIndexDivide256[c]>InitModulationLFOLowerValue[c] ? InitModulationLFOLowerValue[c] : InitModulationIndexDivide256[c];
  LFO[c].isConvergence=InitIsModulationLFOOnce[c];
  LFO[c].isInitializeModulationIndex=InitIsInitializeModulationIndex[c];
  if(LFO[c].changeValue==0||LFO[c].isConvergence||LFO[c].isInitializeModulationIndex){
    wDDS[c].modularIndexDivide256=wDDS[c].tempModularIndexDivide256;
  }
  if(LFO[c].isConvergence||LFO[c].isInitializeModulationIndex){
    LFO[c].mode=false;
  }
  pb[c].interval = InitPitchBendInterval[c];
  pb[c].ratioDivide32768 = InitPitchBendRatioDivide32768[c];
  pb[c].higherFreq = InitPitchBendHigherFreq[c];
  pb[c].lowerFreq = InitPitchBendLowerFreq[c];
}
uint16_t nextNoiseNote(void){
  CON[6].address++;
  uint16_t getNoiseFreq = pgm_read_word(&noiseFreq[CON[6].address]);
  if(getNoiseFreq==0xffff){
    CON[6].address=CON[6].returnAddress;
    noiseParmInit();
    getNoiseFreq = pgm_read_word(&noiseFreq[CON[6].address]);
  }
  CON[6].beepDuration = pgm_read_word(&noiseDuration[CON[6].address]);
  return getNoiseFreq;
}
void noiseParmInit(){
  nDDS.volume=InitVolumeCh[6];
  cEnv(6).attackDuration=InitCarrierEnvelopeAttackDuration[6];
  cEnv(6).decayDuration=InitCarrierEnvelopeDecayDuration[6];
  cEnv(6).sustainDuration=InitCarrierEnvelopeSustainDuration[6];
  cEnv(6).releaseDuration=InitCarrierEnvelopeReleaseDuration[6];
  cEnv(6).attackChangeValue=InitCarrierEnvelopeAttackChangeValue[6];
  cEnv(6).decayChangeValue=InitCarrierEnvelopeDecayChangeValue[6];
  cEnv(6).sustainChangeValue=InitCarrierEnvelopeSustainChangeValue[6];
  cEnv(6).releaseChangeValue=InitCarrierEnvelopeReleaseChangeValue[6];
  cEnv(6).sustainLowerValue=InitCarrierEnvelopeSustainLowerValue[6];
  cEnv(6).releaseLowerValue=InitCarrierEnvelopeReleaseLowerValue[6];
  cEnv(6).sustainMode=InitCarrierEnvelopeSustainMode[6];
  cEnv(6).releaseMode=InitCarrierEnvelopeReleaseMode[6];
  cEnv(6).isAllowOverrideAttackDuty=InitIsAllowOverrideCarrierAttackDuty[6];
  cEnv(6).isEnableRelease=InitIsAllowCarrierInterNoteRelease[6];
  pb[6].interval = InitPitchBendInterval[6];
  pb[6].ratioDivide32768 = InitPitchBendRatioDivide32768[6];
  pb[6].higherFreq = InitPitchBendHigherFreq[6];
  pb[6].lowerFreq = InitPitchBendLowerFreq[6];
  nDDS.mode=InitNoiseMode;
}
ISR(TIMER1_COMPA_vect){ //サンプリング基本音声合成、PWMデューティ比決定、処理を高速化するためにビット演算とアセンブラで処理
  asm(
      ".set ENV_SIZE, %[env_size] \n\t"
      ".set OFFSET_OUTPUTDUTY, %[offset_outputDuty] \n\t"

      ".set CON_SIZE, %[con_size] \n\t"
      ".set OFFSET_CONDUCTOR_FREQ, %[offset_conductorFreq] \n\t"

      ".set WAVE_DDS_SIZE, %[waveDDS_size] \n\t"
      ".set OFFSET_FEEDBACK_GAIN, %[offset_modularFeedbackGainDivide256] \n\t"
      ".set OFFSET_C_ST, %[offset_carrierSamplingTable] \n\t"
      ".set OFFSET_CD_ST, %[offset_carrierDetuneSamplingTable] \n\t"
      ".set OFFSET_M_ST, %[offset_modularSamplingTable] \n\t"
      ".set OFFSET_OUTPUT_CD_DUTY, %[offset_outputCarrierDetuneDuty] \n\t"
      ".set OFFSET_CD_FREQ, %[offset_carrierDetuneFreq] \n\t"
      ".set OFFSET_M_FREQ, %[offset_modularFreq] \n\t"
      ".set OFFSET_C_OP, %[offset_carrierOperator] \n\t"
      ".set OFFSET_CD_OP, %[offset_carrierDetuneOperator] \n\t"
      ".set OFFSET_M_OP, %[offset_modularOperator] \n\t"

      //zero init
      "clr r2\n"
      //modulationOperator[0]+=modulationFreq[0];
      "lds r0,  wDDS + 0*WAVE_DDS_SIZE + OFFSET_M_FREQ\n"
      "lds r1,  wDDS + 0*WAVE_DDS_SIZE + OFFSET_M_FREQ + 1\n"
      "lds r16, wDDS + 0*WAVE_DDS_SIZE + OFFSET_M_OP\n"
      "lds r17, wDDS + 0*WAVE_DDS_SIZE + OFFSET_M_OP + 1\n"
      "add r16, r0\n"
      "adc r17, r1\n"
      "sts wDDS + 0*WAVE_DDS_SIZE + OFFSET_M_OP,r16\n"
      "sts wDDS + 0*WAVE_DDS_SIZE + OFFSET_M_OP + 1,r17\n"
      //fetch aligned modularSamplingTable[0] start hi8 address.
      "lds r31, wDDS + 0*WAVE_DDS_SIZE + OFFSET_M_ST + 1\n"
      //move modulationOperator[0]>>8
      "mov r30, r17\n"
      //modulationFeedback.
      //Z reg indirectly reference.
      "lpm r18, Z\n"
      "lds r19, wDDS + 0*WAVE_DDS_SIZE + OFFSET_FEEDBACK_GAIN\n"
      //apply feedback gain. 
      "mulsu r18, r19\n"
      //modulationOperator[0]+feedbackAmp
      "add r30, r1\n"
      //fetch Modulation Envelope.
      //"lds r19, %[mOutputDutyCH0]\n"
      "lds r19, env + 7*ENV_SIZE + OFFSET_OUTPUTDUTY\n"
      //fetch modulation Duty from SamplingTable[0].
      "lpm r18, Z\n"
      //apply Modulation Envelope.
      "mulsu r18, r19\n"
      //carrierOperator[0]+=CON[0].freq;
      "lds r30, CON + 0*CON_SIZE + OFFSET_CONDUCTOR_FREQ\n"
      "lds r31, CON + 0*CON_SIZE + OFFSET_CONDUCTOR_FREQ + 1\n"
      "lds r16, wDDS + 0*WAVE_DDS_SIZE + OFFSET_C_OP\n"
      "lds r17, wDDS + 0*WAVE_DDS_SIZE + OFFSET_C_OP + 1\n"
      "add r16, r30\n"
      "adc r17, r31\n"
      "sts wDDS + 0*WAVE_DDS_SIZE + OFFSET_C_OP,r16\n"
      "sts wDDS + 0*WAVE_DDS_SIZE + OFFSET_C_OP + 1,r17\n"
      //carrierDetuneOperator[0]+=carrierDetuneFreq[0];
      "lds r30, wDDS + 0*WAVE_DDS_SIZE + OFFSET_CD_FREQ\n"
      "lds r31, wDDS + 0*WAVE_DDS_SIZE + OFFSET_CD_FREQ + 1\n"
      "lds r18, wDDS + 0*WAVE_DDS_SIZE + OFFSET_CD_OP\n"
      "lds r19, wDDS + 0*WAVE_DDS_SIZE + OFFSET_CD_OP + 1\n"
      "add r18, r30\n"
      "adc r19, r31\n"
      "sts wDDS + 0*WAVE_DDS_SIZE + OFFSET_CD_OP,r18\n"
      "sts wDDS + 0*WAVE_DDS_SIZE + OFFSET_CD_OP + 1,r19\n"
      //add modulation Duty to carrierOperator[0] and carrierDetuneOperator[0].
      "add r16, r0\n"
      "adc r17, r1\n"
      "add r18, r0\n"
      "adc r19, r1\n"
      //fetch aligned carrierSamplingTable[0] start hi8 address.
      "lds r31, wDDS + 0*WAVE_DDS_SIZE + OFFSET_C_ST + 1\n"
      //fetch carrier Duty from SamplingTable[0].
      "mov r30, r17\n"
      "lpm r16, Z\n"
      //fetch aligned carrierDetuneSamplingTable[0] start hi8 address.
      "lds r31, wDDS + 0*WAVE_DDS_SIZE + OFFSET_CD_ST + 1\n"
      "mov r30, r19\n"
      "lpm r18, Z\n"
      //apply carrier and carrierDetune Envelope.synthesis output.
      //"lds r17, %[cOutputDutyCH0]\n"
      "lds r17, env + 0*ENV_SIZE + OFFSET_OUTPUTDUTY\n"
      "lds r19, wDDS + 0*WAVE_DDS_SIZE + OFFSET_OUTPUT_CD_DUTY\n"
      "mulsu r16, r17\n"
      "movw r30, r0\n"
      "mulsu r18, r19\n"
      "add r30, r0\n"
      "adc r31, r1\n"
      "clr r22\n"
      "movw r20, r30\n"
      "lsl r31\n"
      "sbci r22, 0\n"
      //"sbrc r31, 7\n"
      //"dec r22\n" //when negatine duty, cast int16 to int24.

      //modulationOperator[1]+=modulationFreq[1];
      "lds r0,  wDDS + 1*WAVE_DDS_SIZE + OFFSET_M_FREQ\n"
      "lds r1,  wDDS + 1*WAVE_DDS_SIZE + OFFSET_M_FREQ + 1\n"
      "lds r16, wDDS + 1*WAVE_DDS_SIZE + OFFSET_M_OP\n"
      "lds r17, wDDS + 1*WAVE_DDS_SIZE + OFFSET_M_OP + 1\n"
      "add r16, r0\n"
      "adc r17, r1\n"
      "sts wDDS + 1*WAVE_DDS_SIZE + OFFSET_M_OP,r16\n"
      "sts wDDS + 1*WAVE_DDS_SIZE + OFFSET_M_OP + 1,r17\n"
      //fetch aligned modularSamplingTable[1] start hi8 address.
      "lds r31, wDDS + 1*WAVE_DDS_SIZE + OFFSET_M_ST + 1\n"
      //move modulationOperator[1]>>8
      "mov r30, r17\n"
      //modulationFeedback.
      //Z reg indirectly reference.
      "lpm r18, Z\n"
      "lds r19, wDDS + 1*WAVE_DDS_SIZE + OFFSET_FEEDBACK_GAIN\n"
      //apply feedback gain. 
      "mulsu r18, r19\n"
      //modulationOperator[1]+feedbackAmp
      "add r30, r1\n"
      //fetch Modulation Envelope.
      //"lds r19, %[mOutputDutyCH1]\n"
      "lds r19, env + 8*ENV_SIZE + OFFSET_OUTPUTDUTY\n"
      //fetch modulation Duty from SamplingTable[1].
      "lpm r18, Z\n"
      //apply Modulation Envelope.
      "mulsu r18, r19\n"
      //carrierOperator[1]+=CON[1].freq;
      "lds r30, CON + 1*CON_SIZE + OFFSET_CONDUCTOR_FREQ\n"
      "lds r31, CON + 1*CON_SIZE + OFFSET_CONDUCTOR_FREQ + 1\n"
      "lds r16, wDDS + 1*WAVE_DDS_SIZE + OFFSET_C_OP\n"
      "lds r17, wDDS + 1*WAVE_DDS_SIZE + OFFSET_C_OP + 1\n"
      "add r16, r30\n"
      "adc r17, r31\n"
      "sts wDDS + 1*WAVE_DDS_SIZE + OFFSET_C_OP,r16\n"
      "sts wDDS + 1*WAVE_DDS_SIZE + OFFSET_C_OP + 1,r17\n"
      //carrierDetuneOperator[1]+=carrierDetuneFreq[1];
      "lds r30, wDDS + 1*WAVE_DDS_SIZE + OFFSET_CD_FREQ\n"
      "lds r31, wDDS + 1*WAVE_DDS_SIZE + OFFSET_CD_FREQ + 1\n"
      "lds r18, wDDS + 1*WAVE_DDS_SIZE + OFFSET_CD_OP\n"
      "lds r19, wDDS + 1*WAVE_DDS_SIZE + OFFSET_CD_OP + 1\n"
      "add r18, r30\n"
      "adc r19, r31\n"
      "sts wDDS + 1*WAVE_DDS_SIZE + OFFSET_CD_OP,r18\n"
      "sts wDDS + 1*WAVE_DDS_SIZE + OFFSET_CD_OP + 1,r19\n"
      //add modulation Duty to carrierOperator[1] and carrierDetuneOperator[1].
      "add r16, r0\n"
      "adc r17, r1\n"
      "add r18, r0\n"
      "adc r19, r1\n"
      //fetch aligned carrierSamplingTable[1] start hi8 address.
      "lds r31, wDDS + 1*WAVE_DDS_SIZE + OFFSET_C_ST + 1\n"
      //fetch carrier Duty from SamplingTable[1].
      "mov r30, r17\n"
      "lpm r16, Z\n"
      //fetch aligned carrierDetuneSamplingTable[1] start hi8 address.
      "lds r31, wDDS + 1*WAVE_DDS_SIZE + OFFSET_CD_ST + 1\n"
      "mov r30, r19\n"
      "lpm r18, Z\n"
      //apply carrier and carrierDetune Envelope.synthesis output.
      //"lds r17, %[cOutputDutyCH1]\n"
      "lds r17, env + 1*ENV_SIZE + OFFSET_OUTPUTDUTY\n"
      "lds r19, wDDS + 1*WAVE_DDS_SIZE + OFFSET_OUTPUT_CD_DUTY\n"
      "mulsu r16, r17\n"
      "movw r30, r0\n"
      "mulsu r18, r19\n"
      "add r30, r0\n"
      "adc r31, r1\n"
      //"sbrc r31, 7\n"
      //"dec r22\n" //when negatine duty, cast int16 to int24.
      "add r20, r30\n"
      "adc r21, r31\n"
      "adc r22, r2\n"
      "lsl r31\n"
      "sbci r22, 0\n"
      
      //modulationOperator[2]+=modulationFreq[2];
      "lds r0,  wDDS + 2*WAVE_DDS_SIZE + OFFSET_M_FREQ\n"
      "lds r1,  wDDS + 2*WAVE_DDS_SIZE + OFFSET_M_FREQ + 1\n"
      "lds r16, wDDS + 2*WAVE_DDS_SIZE + OFFSET_M_OP\n"
      "lds r17, wDDS + 2*WAVE_DDS_SIZE + OFFSET_M_OP + 1\n"
      "add r16, r0\n"
      "adc r17, r1\n"
      "sts wDDS + 2*WAVE_DDS_SIZE + OFFSET_M_OP,r16\n"
      "sts wDDS + 2*WAVE_DDS_SIZE + OFFSET_M_OP + 1,r17\n"
      //fetch aligned modularSamplingTable[2] start hi8 address.
      "lds r31, wDDS + 2*WAVE_DDS_SIZE + OFFSET_M_ST + 1\n"
      //move modulationOperator[2]>>8
      "mov r30, r17\n"
      //modulationFeedback.
      //Z reg indirectly reference.
      "lpm r18, Z\n"
      "lds r19, wDDS + 2*WAVE_DDS_SIZE + OFFSET_FEEDBACK_GAIN\n"
      //apply feedback gain. 
      "mulsu r18, r19\n"
      //modulationOperator[2]+feedbackAmp
      "add r30, r1\n"
      //fetch Modulation Envelope.
      //"lds r19, %[mOutputDutyCH2]\n"
      "lds r19, env + 9*ENV_SIZE + OFFSET_OUTPUTDUTY\n"
      //fetch modulation Duty from SamplingTable[2].
      "lpm r18, Z\n"
      //apply Modulation Envelope.
      "mulsu r18, r19\n"
      //carrierOperator[2]+=CON[2].freq;
      "lds r30, CON + 2*CON_SIZE + OFFSET_CONDUCTOR_FREQ\n"
      "lds r31, CON + 2*CON_SIZE + OFFSET_CONDUCTOR_FREQ + 1\n"
      "lds r16, wDDS + 2*WAVE_DDS_SIZE + OFFSET_C_OP\n"
      "lds r17, wDDS + 2*WAVE_DDS_SIZE + OFFSET_C_OP + 1\n"
      "add r16, r30\n"
      "adc r17, r31\n"
      "sts wDDS + 2*WAVE_DDS_SIZE + OFFSET_C_OP,r16\n"
      "sts wDDS + 2*WAVE_DDS_SIZE + OFFSET_C_OP + 1,r17\n"
      //carrierDetuneOperator[2]+=carrierDetuneFreq[2];
      "lds r30, wDDS + 2*WAVE_DDS_SIZE + OFFSET_CD_FREQ\n"
      "lds r31, wDDS + 2*WAVE_DDS_SIZE + OFFSET_CD_FREQ + 1\n"
      "lds r18, wDDS + 2*WAVE_DDS_SIZE + OFFSET_CD_OP\n"
      "lds r19, wDDS + 2*WAVE_DDS_SIZE + OFFSET_CD_OP + 1\n"
      "add r18, r30\n"
      "adc r19, r31\n"
      "sts wDDS + 2*WAVE_DDS_SIZE + OFFSET_CD_OP,r18\n"
      "sts wDDS + 2*WAVE_DDS_SIZE + OFFSET_CD_OP + 1,r19\n"
      //add modulation Duty to carrierOperator[2] and carrierDetuneOperator[2].
      "add r16, r0\n"
      "adc r17, r1\n"
      "add r18, r0\n"
      "adc r19, r1\n"
      //fetch aligned carrierSamplingTable[2] start hi8 address.
      "lds r31, wDDS + 2*WAVE_DDS_SIZE + OFFSET_C_ST + 1\n"
      //fetch carrier Duty from SamplingTable[2].
      "mov r30, r17\n"
      "lpm r16, Z\n"
      //fetch aligned carrierDetuneSamplingTable[2] start hi8 address.
      "lds r31, wDDS + 2*WAVE_DDS_SIZE + OFFSET_CD_ST + 1\n"
      "mov r30, r19\n"
      "lpm r18, Z\n"
      //apply carrier and carrierDetune Envelope.synthesis output.
      //"lds r17, %[cOutputDutyCH2]\n"
      "lds r17, env + 2*ENV_SIZE + OFFSET_OUTPUTDUTY\n"
      "lds r19, wDDS + 2*WAVE_DDS_SIZE + OFFSET_OUTPUT_CD_DUTY\n"
      "mulsu r16, r17\n"
      "movw r30, r0\n"
      "mulsu r18, r19\n"
      "add r30, r0\n"
      "adc r31, r1\n"
      //"sbrc r31, 7\n"
      //"dec r22\n" //when negatine duty, cast int16 to int24.
      "add r20, r30\n"
      "adc r21, r31\n"
      "adc r22, r2\n"
      "lsl r31\n"
      "sbci r22, 0\n"

      //modulationOperator[3]+=modulationFreq[3];
      "lds r0,  wDDS + 3*WAVE_DDS_SIZE + OFFSET_M_FREQ\n"
      "lds r1,  wDDS + 3*WAVE_DDS_SIZE + OFFSET_M_FREQ + 1\n"
      "lds r16, wDDS + 3*WAVE_DDS_SIZE + OFFSET_M_OP\n"
      "lds r17, wDDS + 3*WAVE_DDS_SIZE + OFFSET_M_OP + 1\n"
      "add r16, r0\n"
      "adc r17, r1\n"
      "sts wDDS + 3*WAVE_DDS_SIZE + OFFSET_M_OP,r16\n"
      "sts wDDS + 3*WAVE_DDS_SIZE + OFFSET_M_OP + 1,r17\n"
      //fetch aligned modularSamplingTable[3] start hi8 address.
      "lds r31, wDDS + 3*WAVE_DDS_SIZE + OFFSET_M_ST + 1\n"
      //move modulationOperator[3]>>8
      "mov r30, r17\n"
      //modulationFeedback.
      //Z reg indirectly reference.
      "lpm r18, Z\n"
      "lds r19, wDDS + 3*WAVE_DDS_SIZE + OFFSET_FEEDBACK_GAIN\n"
      //apply feedback gain. 
      "mulsu r18, r19\n"
      //modulationOperator[3]+feedbackAmp
      "add r30, r1\n"
      //fetch Modulation Envelope.
      //"lds r19, %[mOutputDutyCH3]\n"
      "lds r19, env + 10*ENV_SIZE + OFFSET_OUTPUTDUTY\n"
      //fetch modulation Duty from SamplingTable[3].
      "lpm r18, Z\n"
      //apply Modulation Envelope.
      "mulsu r18, r19\n"
      //carrierOperator[3]+=CON[3].freq;
      "lds r30, CON + 3*CON_SIZE + OFFSET_CONDUCTOR_FREQ\n"
      "lds r31, CON + 3*CON_SIZE + OFFSET_CONDUCTOR_FREQ + 1\n"
      "lds r16, wDDS + 3*WAVE_DDS_SIZE + OFFSET_C_OP\n"
      "lds r17, wDDS + 3*WAVE_DDS_SIZE + OFFSET_C_OP + 1\n"
      "add r16, r30\n"
      "adc r17, r31\n"
      "sts wDDS + 3*WAVE_DDS_SIZE + OFFSET_C_OP,r16\n"
      "sts wDDS + 3*WAVE_DDS_SIZE + OFFSET_C_OP + 1,r17\n"
      //carrierDetuneOperator[3]+=carrierDetuneFreq[3];
      "lds r30, wDDS + 3*WAVE_DDS_SIZE + OFFSET_CD_FREQ\n"
      "lds r31, wDDS + 3*WAVE_DDS_SIZE + OFFSET_CD_FREQ + 1\n"
      "lds r18, wDDS + 3*WAVE_DDS_SIZE + OFFSET_CD_OP\n"
      "lds r19, wDDS + 3*WAVE_DDS_SIZE + OFFSET_CD_OP + 1\n"
      "add r18, r30\n"
      "adc r19, r31\n"
      "sts wDDS + 3*WAVE_DDS_SIZE + OFFSET_CD_OP,r18\n"
      "sts wDDS + 3*WAVE_DDS_SIZE + OFFSET_CD_OP + 1,r19\n"
      //add modulation Duty to carrierOperator[3] and carrierDetuneOperator[3].
      "add r16, r0\n"
      "adc r17, r1\n"
      "add r18, r0\n"
      "adc r19, r1\n"
      //fetch aligned carrierSamplingTable[3] start hi8 address.
      "lds r31, wDDS + 3*WAVE_DDS_SIZE + OFFSET_C_ST + 1\n"
      //fetch carrier Duty from SamplingTable[3].
      "mov r30, r17\n"
      "lpm r16, Z\n"
      //fetch aligned carrierDetuneSamplingTable[3] start hi8 address.
      "lds r31, wDDS + 3*WAVE_DDS_SIZE + OFFSET_CD_ST + 1\n"
      "mov r30, r19\n"
      "lpm r18, Z\n"
      //apply carrier and carrierDetune Envelope.synthesis output.
      //"lds r17, %[cOutputDutyCH3]\n"
      "lds r17, env + 3*ENV_SIZE + OFFSET_OUTPUTDUTY\n"
      "lds r19, wDDS + 3*WAVE_DDS_SIZE + OFFSET_OUTPUT_CD_DUTY\n"
      "mulsu r16, r17\n"
      "movw r30, r0\n"
      "mulsu r18, r19\n"
      "add r30, r0\n"
      "adc r31, r1\n"
      //"sbrc r31, 7\n"
      //"dec r22\n" //when negatine duty, cast int16 to int24.
      "add r20, r30\n"
      "adc r21, r31\n"
      "adc r22, r2\n"
      "lsl r31\n"
      "sbci r22, 0\n"

      //modulationOperator[4]+=modulationFreq[4];
      "lds r0,  wDDS + 4*WAVE_DDS_SIZE + OFFSET_M_FREQ\n"
      "lds r1,  wDDS + 4*WAVE_DDS_SIZE + OFFSET_M_FREQ + 1\n"
      "lds r16, wDDS + 4*WAVE_DDS_SIZE + OFFSET_M_OP\n"
      "lds r17, wDDS + 4*WAVE_DDS_SIZE + OFFSET_M_OP + 1\n"
      "add r16, r0\n"
      "adc r17, r1\n"
      "sts wDDS + 4*WAVE_DDS_SIZE + OFFSET_M_OP,r16\n"
      "sts wDDS + 4*WAVE_DDS_SIZE + OFFSET_M_OP + 1,r17\n"
      //fetch aligned modularSamplingTable[4] start hi8 address.
      "lds r31, wDDS + 4*WAVE_DDS_SIZE + OFFSET_M_ST + 1\n"
      //move modulationOperator[4]>>8
      "mov r30, r17\n"
      //modulationFeedback.
      //Z reg indirectly reference.
      "lpm r18, Z\n"
      "lds r19, wDDS + 4*WAVE_DDS_SIZE + OFFSET_FEEDBACK_GAIN\n"
      //apply feedback gain. 
      "mulsu r18, r19\n"
      //modulationOperator[4]+feedbackAmp
      "add r30, r1\n"
      //fetch Modulation Envelope.
      //"lds r19, %[mOutputDutyCH4]\n"
      "lds r19, env + 11*ENV_SIZE + OFFSET_OUTPUTDUTY\n"
      //fetch modulation Duty from SamplingTable[4].
      "lpm r18, Z\n"
      //apply Modulation Envelope.
      "mulsu r18, r19\n"
      //carrierOperator[4]+=CON[4].freq;
      "lds r30, CON + 4*CON_SIZE + OFFSET_CONDUCTOR_FREQ\n"
      "lds r31, CON + 4*CON_SIZE + OFFSET_CONDUCTOR_FREQ + 1\n"
      "lds r16, wDDS + 4*WAVE_DDS_SIZE + OFFSET_C_OP\n"
      "lds r17, wDDS + 4*WAVE_DDS_SIZE + OFFSET_C_OP + 1\n"
      "add r16, r30\n"
      "adc r17, r31\n"
      "sts wDDS + 4*WAVE_DDS_SIZE + OFFSET_C_OP,r16\n"
      "sts wDDS + 4*WAVE_DDS_SIZE + OFFSET_C_OP + 1,r17\n"
      //carrierDetuneOperator[4]+=carrierDetuneFreq[4];
      "lds r30, wDDS + 4*WAVE_DDS_SIZE + OFFSET_CD_FREQ\n"
      "lds r31, wDDS + 4*WAVE_DDS_SIZE + OFFSET_CD_FREQ + 1\n"
      "lds r18, wDDS + 4*WAVE_DDS_SIZE + OFFSET_CD_OP\n"
      "lds r19, wDDS + 4*WAVE_DDS_SIZE + OFFSET_CD_OP + 1\n"
      "add r18, r30\n"
      "adc r19, r31\n"
      "sts wDDS + 4*WAVE_DDS_SIZE + OFFSET_CD_OP,r18\n"
      "sts wDDS + 4*WAVE_DDS_SIZE + OFFSET_CD_OP + 1,r19\n"
      //add modulation Duty to carrierOperator[4] and carrierDetuneOperator[4].
      "add r16, r0\n"
      "adc r17, r1\n"
      "add r18, r0\n"
      "adc r19, r1\n"
      //fetch aligned carrierSamplingTable[4] start hi8 address.
      "lds r31, wDDS + 4*WAVE_DDS_SIZE + OFFSET_C_ST + 1\n"
      //fetch carrier Duty from SamplingTable[4].
      "mov r30, r17\n"
      "lpm r16, Z\n"
      //fetch aligned carrierDetuneSamplingTable[4] start hi8 address.
      "lds r31, wDDS + 4*WAVE_DDS_SIZE + OFFSET_CD_ST + 1\n"
      "mov r30, r19\n"
      "lpm r18, Z\n"
      //apply carrier and carrierDetune Envelope.synthesis output.
      //"lds r17, %[cOutputDutyCH4]\n"
      "lds r17, env + 4*ENV_SIZE + OFFSET_OUTPUTDUTY\n"
      "lds r19, wDDS + 4*WAVE_DDS_SIZE + OFFSET_OUTPUT_CD_DUTY\n"
      "mulsu r16, r17\n"
      "movw r30, r0\n"
      "mulsu r18, r19\n"
      "add r30, r0\n"
      "adc r31, r1\n"
      //"sbrc r31, 7\n"
      //"dec r22\n" //when negatine duty, cast int16 to int24.
      "add r20, r30\n"
      "adc r21, r31\n"
      "adc r22, r2\n"
      "lsl r31\n"
      "sbci r22, 0\n"

      //modulationOperator[5]+=modulationFreq[5];
      "lds r0,  wDDS + 5*WAVE_DDS_SIZE + OFFSET_M_FREQ\n"
      "lds r1,  wDDS + 5*WAVE_DDS_SIZE + OFFSET_M_FREQ + 1\n"
      "lds r16, wDDS + 5*WAVE_DDS_SIZE + OFFSET_M_OP\n"
      "lds r17, wDDS + 5*WAVE_DDS_SIZE + OFFSET_M_OP + 1\n"
      "add r16, r0\n"
      "adc r17, r1\n"
      "sts wDDS + 5*WAVE_DDS_SIZE + OFFSET_M_OP,r16\n"
      "sts wDDS + 5*WAVE_DDS_SIZE + OFFSET_M_OP + 1,r17\n"
      //fetch aligned modularSamplingTable[5] start hi8 address.
      "lds r31, wDDS + 5*WAVE_DDS_SIZE + OFFSET_M_ST + 1\n"
      //move modulationOperator[5]>>8
      "mov r30, r17\n"
      //modulationFeedback.
      //Z reg indirectly reference.
      "lpm r18, Z\n"
      "lds r19, wDDS + 5*WAVE_DDS_SIZE + OFFSET_FEEDBACK_GAIN\n"
      //apply feedback gain. 
      "mulsu r18, r19\n"
      //modulationOperator[5]+feedbackAmp
      "add r30, r1\n"
      //fetch Modulation Envelope.
      //"lds r19, %[mOutputDutyCH5]\n"
      "lds r19, env + 12*ENV_SIZE + OFFSET_OUTPUTDUTY\n"
      //fetch modulation Duty from SamplingTable[5].
      "lpm r18, Z\n"
      //apply Modulation Envelope.
      "mulsu r18, r19\n"
      //carrierOperator[5]+=CON[5].freq;
      "lds r30, CON + 5*CON_SIZE + OFFSET_CONDUCTOR_FREQ\n"
      "lds r31, CON + 5*CON_SIZE + OFFSET_CONDUCTOR_FREQ + 1\n"
      "lds r16, wDDS + 5*WAVE_DDS_SIZE + OFFSET_C_OP\n"
      "lds r17, wDDS + 5*WAVE_DDS_SIZE + OFFSET_C_OP + 1\n"
      "add r16, r30\n"
      "adc r17, r31\n"
      "sts wDDS + 5*WAVE_DDS_SIZE + OFFSET_C_OP,r16\n"
      "sts wDDS + 5*WAVE_DDS_SIZE + OFFSET_C_OP + 1,r17\n"
      //carrierDetuneOperator[5]+=carrierDetuneFreq[5];
      "lds r30, wDDS + 5*WAVE_DDS_SIZE + OFFSET_CD_FREQ\n"
      "lds r31, wDDS + 5*WAVE_DDS_SIZE + OFFSET_CD_FREQ + 1\n"
      "lds r18, wDDS + 5*WAVE_DDS_SIZE + OFFSET_CD_OP\n"
      "lds r19, wDDS + 5*WAVE_DDS_SIZE + OFFSET_CD_OP + 1\n"
      "add r18, r30\n"
      "adc r19, r31\n"
      "sts wDDS + 5*WAVE_DDS_SIZE + OFFSET_CD_OP,r18\n"
      "sts wDDS + 5*WAVE_DDS_SIZE + OFFSET_CD_OP + 1,r19\n"
      //add modulation Duty to carrierOperator[5] and carrierDetuneOperator[5].
      "add r16, r0\n"
      "adc r17, r1\n"
      "add r18, r0\n"
      "adc r19, r1\n"
      //fetch aligned carrierSamplingTable[5] start hi8 address.
      "lds r31, wDDS + 5*WAVE_DDS_SIZE + OFFSET_C_ST + 1\n"
      //fetch carrier Duty from SamplingTable[5].
      "mov r30, r17\n"
      "lpm r16, Z\n"
      //fetch aligned carrierDetuneSamplingTable[5] start hi8 address.
      "lds r31, wDDS + 5*WAVE_DDS_SIZE + OFFSET_CD_ST + 1\n"
      "mov r30, r19\n"
      "lpm r18, Z\n"
      //apply carrier and carrierDetune Envelope.synthesis output.
      //"lds r17, %[cOutputDutyCH5]\n"
      "lds r17, env + 5*ENV_SIZE + OFFSET_OUTPUTDUTY\n"
      "lds r19, wDDS + 5*WAVE_DDS_SIZE + OFFSET_OUTPUT_CD_DUTY\n"
      "mulsu r16, r17\n"
      "movw r30, r0\n"
      "mulsu r18, r19\n"
      "add r30, r0\n"
      "adc r31, r1\n"
      //"sbrc r31, 7\n"
      //"dec r22\n" //when negatine duty, cast int16 to int24.
      "add r20, r30\n"
      "adc r21, r31\n"
      "adc r22, r2\n"
      "lsl r31\n"
      "sbci r22, 0\n"

      //noise genarate. ノイズ結果をr22に保存
      //noiseOperator+=CON[6].freq;
      "lds r0,  CON + 6*CON_SIZE + OFFSET_CONDUCTOR_FREQ\n"
      "lds r1,  CON + 6*CON_SIZE + OFFSET_CONDUCTOR_FREQ + 1\n"
      "lds r18, %[noiseOperator]\n"
      "lds r19, %[noiseOperator] + 1\n"
      "add r18, r0\n"
      "adc r19, r1\n"
      "sts %[noiseOperator],r18\n"
      "sts %[noiseOperator] + 1,r19\n"
      //キャリー検出分岐
      "brcc notCarry\n"
    "isCarry:"
      "lds r16, %[noiseMode]\n"
      "cpi r16, 0x00\n"
      "breq noiseMode0\n"//一致で分岐
      "cpi r16, 0x01\n"
      "breq noiseMode1\n"//一致で分岐
      "cpi r16, 0x02\n"
      "breq noiseMode2\n"//一致で分岐
    "noiseMode0:"
      //noise=(getADC&0x01)^(getADC&0x02)>>1;
      //ADCSRA|=0b01000000;
      "lds r16, 0x79\n"//ADCH取得
      "lds r17, 0x7A\n"//ADCSRA取得
      "ori r17, 0x40\n"//ADC変換開始
      "sts 0x7A, r17\n"//
      "lds r17, %[noise]\n"
      "eor r17, r16\n"
      "sts %[noise], r17\n"
      "rjmp notCarry\n"
    "noiseMode1:"
      //noiseRegister>>=1;
      //noiseRegister |= ((noiseRegister^(noiseRegister>>1))&1)<<15;
      //noise=noiseRegister;
      "lds r16, %[noiseRegister]\n"
      "lds r17, %[noiseRegister] + 1\n"
      "lsr r17\n" //上位バイト右シフト
      "ror r16\n" //キャリーを含めた下位バイト右シフト
      "movw r18, r16\n"
      "ror r18\n" //キャリーを含めた下位バイト右シフト
      "rjmp LFSR\n"
    "noiseMode2:"
      //noiseRegister>>=1;
      //noiseRegister |= ((noiseRegister^(noiseRegister>>6))&1)<<15;
      //noise=noiseRegister;
      "lds r16, %[noiseRegister]\n"
      "lds r17, %[noiseRegister] + 1\n"
      "lsr r17\n" //上位バイト右シフト
      "ror r16\n" //キャリーを含めた下位バイト右シフト
      "movw r18, r16\n"
      "rol r16\n" //キャリーを含めた上位バイト左シフト
      "rol r16\n" //キャリーを含めた上位バイト左シフト
    "LFSR:"
      "eor r18, r16\n"
      "andi r18, 0x01\n"
      "sbrc r18, 0\n"
      "ori r17, 0x80\n"
      "sts %[noiseRegister], r16\n"
      "sts %[noiseRegister] + 1, r17\n"
      "sts %[noise], r16\n"
    "notCarry:"
      //"lds r30, %[cOutputDutyCH6]\n"
      "lds r30, env + 6*ENV_SIZE + OFFSET_OUTPUTDUTY\n"
      "lds r20, %[noise]\n"
      "sbrs r20, 0\n"
      "rjmp noiseFalse\n"
    "noiseTrue:"
      "add r21, r30\n"
      "adc r22, r2\n"
      "rjmp output\n"
    "noiseFalse:"
      "sub r21, r30\n"
      "sbc r22, r2\n"
    "output:"
      "ser r16\n"     //0xFF
      "sbrc r22, 7\n" //7bit0で次命令スキップ
      "rjmp negDuty\n"
    "posDuty:"
      "com r21\n"
      "out 0x28, r16\n" //OCR0B設定
      "out 0x27, r21\n" //OCR0A設定
      "rjmp end\n"
    "negDuty:"
      "dec r21\n"  //255足す
      "out 0x27, r16\n" //OCR0A設定
      "out 0x28, r21\n" //OCR0B設定
    "end:"
      :
      :[con_size] "i" (sizeof(conductor)),
       [offset_conductorFreq] "i" (offsetof(conductor, freq)),
       [waveDDS_size] "i" (sizeof(waveDDS)),
       [offset_modularFeedbackGainDivide256] "i" (offsetof(waveDDS, modularFeedbackGainDivide256)),
       [offset_carrierSamplingTable] "i" (offsetof(waveDDS, carrierSamplingTable)),
       [offset_carrierDetuneSamplingTable] "i" (offsetof(waveDDS, carrierDetuneSamplingTable)),
       [offset_modularSamplingTable] "i" (offsetof(waveDDS, modularSamplingTable)),
       [offset_outputCarrierDetuneDuty] "i" (offsetof(waveDDS, outputCarrierDetuneDuty)),
       [offset_carrierDetuneFreq] "i" (offsetof(waveDDS, carrierDetuneFreq)),
       [offset_modularFreq] "i" (offsetof(waveDDS, modularFreq)),
       [offset_carrierOperator] "i" (offsetof(waveDDS, carrierOperator)),
       [offset_carrierDetuneOperator] "i" (offsetof(waveDDS, carrierDetuneOperator)),
       [offset_modularOperator] "i" (offsetof(waveDDS, modularOperator)),
       [env_size] "i" (sizeof(envelope)),
       [offset_outputDuty] "i" (offsetof(envelope, outputDuty)),
       [noiseRegister] "i" (&nDDS.noiseRegister),
       [noiseOperator] "i" (&nDDS.noiseOperator),
       [noiseMode] "i" (&nDDS.mode),
       [noise] "i" (&nDDS.noise)
      :"r0","r1","r2","r16","r17","r18","r19","r20","r21","r22","r30","r31" //duty 3byte r22:r21:r20
  );
}
ISR(TIMER2_COMPA_vect){ //基準時間生成
  asm(
    "lds r0, %[refMs]\n"
    "inc r0\n"
    "sts %[refMs], r0\n"
    :
    : [refMs] "i" (&refMs)
    :"r0"
  );
}
/*//IIR
      "mov r16, r31\n"
      "ldi r18, 128\n"
      "com r18\n"
      "mulsu r16,r18\n"
      "movw r16, r0\n"
      "com r18\n"
      "lds r19, (prevAmp)\n"
      "mulsu r19,r18\n"
      "add r16, r0\n"
      "adc r17, r1\n"
      "sts (prevAmp), r17\n"
      "movw r30, r16\n"
      //
      */